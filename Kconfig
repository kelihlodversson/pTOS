## bios/Kconfig
```kconfig
#
# bios/Kconfig - hardware support
#
# Copyright (C) 2001-2017 The EmuTOS development team.
#
# This file is distributed under the GPL, version 2 or at your
# option any later version.  See doc/license.txt for details.
#

menu "Memory"

config CONF_STRAM_SIZE
	hex "Size of the ST-RAM, in bytes (0 = autodetect)"
	default 0xe00000 if MACHINE_M548X
	default 0x0
	help
	  Actual size of the ST-RAM.  If set to 0, the amount of ST-RAM is
	  detected at boot time.

config CONF_WITH_ALT_RAM
	bool "Alternate RAM support"
	default n if TARGET_192 || TARGET_CART
	default y
	help
	  Support RAM outside of the 14 MB ST-RAM area, made available to
	  applications through Maddalt()/Mxalloc().

config CONF_WITH_MAGNUM
	bool "Magnum Alt-RAM board support"
	depends on CONF_ATARI_HARDWARE
	default n if MACHINE_ARANYM || MACHINE_FIREBEE
	default y
	help
	  Detect a Magnum Alt-RAM expansion board and add its memory via
	  Maddalt(), as for other Alt-RAM sources (see CONF_WITH_ALT_RAM).
	  Detection is a runtime probe, so it is safe to leave enabled on
	  hardware/emulators that lack the board.

config CONF_WITH_MEMORY_TEST
	bool "Memory test on cold boot"
	default n
	help
	  Run a RAM test during a cold boot and report any faulty memory
	  found.  Adds to boot time, so it is off by default.

config CONF_WITH_TTRAM
	bool "TT-RAM detection"
	depends on CONF_WITH_ALT_RAM && !ARCH_ARM
	default n if TARGET_192 || MACHINE_AMIGA || MACHINE_VIRT_M68K
	default y
	help
	  Detect and use the fast RAM found in the 32-bit address space of
	  TT and Falcon compatible machines.

	  This cannot be selected on ARM: TT-RAM is reported through the
	  ramtop/ramvalid system variables, which do not exist in the ARM
	  variant of the fixed sysvars layout (see tosvars.ld).

config CONF_TTRAM_SIZE
	hex "Size of the TT-RAM, in bytes (0 = autodetect)"
	depends on CONF_WITH_TTRAM
	default 0x3000000 if MACHINE_M548X
	default 0x0
	help
	  Actual size of the TT-RAM.  If set to 0, the amount of TT-RAM is
	  detected at boot time.

config CONF_WITH_STATIC_ALT_RAM
	bool "Put the EmuTOS static data in Alt-RAM"
	depends on CONF_WITH_ALT_RAM
	default n
	help
	  This can only work if the main Alt-RAM address is known at compile
	  time.  The actual Alt-RAM region is described in emutos.ld.

config STATIC_ALT_RAM_ADDRESS
	hex "Address of the static Alt-RAM region"
	depends on CONF_WITH_STATIC_ALT_RAM
	default 0x08000000
	help
	  Start address of the Alt-RAM region known at compile time.

config STATIC_ALT_RAM_SIZE
	hex "Size of the static Alt-RAM region"
	depends on CONF_WITH_STATIC_ALT_RAM
	help
	  Size of the Alt-RAM region, when it is known at compile time.
	  Leave this empty to have the size determined at boot time.

config CONF_WITH_FRB
	bool "_FRB cookie"
	depends on CONF_WITH_ALT_RAM && CONF_ATARI_HARDWARE
	default y
	help
	  Automatically allocate the _FRB buffer used by DMA transfers to and
	  from Alt-RAM, and publish the matching cookie.

config CONF_WITH_ST_MMU
	bool "ST MMU support"
	depends on CONF_ATARI_HARDWARE
	default n if MACHINE_FIREBEE
	default y

config CONF_WITH_TT_MMU
	bool "TT MMU support"
	depends on CONF_ATARI_HARDWARE
	default n if TARGET_192 || TARGET_CART || MACHINE_FIREBEE
	default y

config CONF_WITH_FALCON_MMU
	bool "Falcon MMU support"
	depends on CONF_ATARI_HARDWARE
	default n if TARGET_192 || TARGET_CART
	default y

config CONF_DETECT_FIRST_BOOT_WITHOUT_MEMCONF
	bool "Detect the first boot without using memconf"
	default y if EMUTOS_LIVES_IN_RAM || MACHINE_FIREBEE || MACHINE_M548X
	default n
	help
	  Detect a first boot even when memconf is not called.  This is
	  useful when the RAM is already initialized before EmuTOS boots,
	  which is always the case on the FireBee, where the RAM is set up
	  by the BaS, and whenever EmuTOS itself lives in RAM.

endmenu

menu "Storage devices"

config CONF_WITH_ACSI
	bool "ACSI support"
	depends on CONF_ATARI_HARDWARE
	default n if MACHINE_ARANYM || MACHINE_FIREBEE
	default y
	help
	  Support for the Atari ACSI hard disk interface.  It is broken in
	  the current FireBee hardware and is not emulated by ARAnyM.

config CONF_WITH_SCSI
	bool "SCSI support"
	depends on CONF_ATARI_HARDWARE && CONF_WITH_MFP
	default n if TARGET_192 || TARGET_256 || TARGET_CART || MACHINE_ARANYM || MACHINE_FIREBEE
	default y
	help
	  Support for the NCR5380 SCSI interface of the TT and the Falcon.

config CONF_WITH_EXTERNAL_DISK_DRIVER
	bool "Deactivate built-in disk drivers for an external driver"
	default n
	help
	  Deactivate EmuTOS's own ACSI/IDE/SCSI partition scanning and the
	  built-in XHDI/SCSI Driver interfaces, for use with an external
	  disk driver loaded from disk instead.  Mutually exclusive with
	  CONF_WITH_SCSI_DRIVER; leave off unless you have such a driver.

config CONF_WITH_SCSI_DRIVER
	bool "SCSI Driver (XHDI) interface"
	depends on !CONF_WITH_EXTERNAL_DISK_DRIVER
	default y
	help
	  Provide the XHDI "SCSI Driver" interface, giving applications
	  generic SCSI/ATAPI command pass-through to the ACSI/IDE/SCSI
	  block devices.

config CONF_WITH_GPT_SUPPORT
	bool "GPT (GUID Partition Table) support"
	default y
	help
	  Recognise GPT-partitioned hard disks in addition to the classic
	  MBR/AHDI partition tables.

config CONF_WITH_VAMPIRE_SPI
	bool "Vampire (SAGA core) SD/MMC SPI support"
	depends on MACHINE_AMIGA
	default y if MACHINE_AMIGA
	default n
	help
	  SD/MMC card support over the SPI interface of the Apollo Vampire
	  accelerator's SAGA core.

config CONF_WITH_1FAT_SUPPORT
	bool "Single-FAT disk support"
	default y
	help
	  Support for FAT-format disks with only a single FAT (File
	  Allocation Table) instead of the usual two.  Disabling this
	  saves a small amount of code and assumes every disk has two
	  FATs, like Atari TOS does.

config CONF_WITH_IDE
	bool "IDE support"
	default n if TARGET_192 || TARGET_CART || MACHINE_RPI
	default y
	help
	  Support for the IDE interface found on the Falcon, on the Amiga
	  and on the ColdFire boards.

config CONF_WITH_SDMMC
	bool "SD/MMC bus support"
	default y if MACHINE_FIREBEE
	default n
	help
	  Support for SD and MMC cards attached to an SPI bus.

config CONF_WITH_RASPI_EMMC
	bool "Raspberry Pi EMMC (SD card) support"
	depends on MACHINE_RPI
	default y
	help
	  Support for the SD card slot of the Raspberry Pi, using the
	  on-chip EMMC controller.

config CONF_WITH_VIRTIO
	bool "virtio-mmio transport support"
	depends on MACHINE_VIRT_ARM || MACHINE_VIRT_M68K
	default y
	help
	  Shared driver for the virtio-mmio transports QEMU's ARM and m68k
	  'virt' boards expose. No effect without a device driver built on
	  top of it (see CONF_WITH_VIRTIO_BLK).

config CONF_WITH_VIRTIO_BLK
	bool "virtio-blk disk driver"
	depends on CONF_WITH_VIRTIO
	default y
	help
	  Block device driver for virtio-blk devices found on the
	  virtio-mmio transport. Devices appear as a new disk bus,
	  partitioned the same way as ACSI/IDE/SD devices.

config CONF_WITH_VIRTIO_INPUT
	bool "virtio-input keyboard/mouse driver"
	depends on CONF_WITH_VIRTIO
	default y
	help
	  Keyboard and mouse/tablet driver for virtio-input devices found on
	  the virtio-mmio transport, for the QEMU virt-arm/virt-m68k boards.
	  No effect without a virtio-keyboard-device / virtio-tablet-device /
	  virtio-mouse-device on the QEMU command line.

config CONF_WITH_VIRTIO_9P
	bool "virtio-9p (9P2000.L) GEMDOS host directory driver"
	depends on CONF_WITH_VIRTIO && CONF_WITH_PLUGGABLE_FS
	default y
	help
	  Exposes a QEMU virtio-9p-device host directory ("-fsdev local ...
	  -device virtio-9p-device,mount_tag=...") as a GEMDOS drive, for the
	  virt-arm/virt-m68k boards. No effect without a matching device on
	  the QEMU command line.

config CONF_VIRTIO_9P_MSIZE
	int "virtio-9p max message size (msize)"
	depends on CONF_WITH_VIRTIO_9P
	default 8192
	range 1024 65536
	help
	  Negotiated with the device via Tversion; bounds per-request
	  read/write chunk size. Costs 2x this value in static RAM (request
	  and reply buffers).

config CONF_VIRTIO_9P_MAX_FIDS
	int "Maximum concurrent virtio-9p fids"
	depends on CONF_WITH_VIRTIO_9P
	default 96
	range 16 256
	help
	  Fixed pool of 9p fid slots, one per live pluggable-fs cookie this
	  driver owns (see fs/pfs.h's PFSCOOKIE). Budget: OPNFILES (40) +
	  CONF_PFS_MAX_CWD (default 40) + CONF_PFS_MAX_SEARCHES (default 8)
	  + headroom for fids held transiently mid-call (e.g. while walking
	  a multi-component path).

config CONF_VIRTIO_9P_DRIVE
	int "Drive letter for the virtio-9p host directory (0=A: ... 25=Z:)"
	depends on CONF_WITH_VIRTIO_9P
	default 16
	range 0 25
	help
	  Fixed drive letter this driver claims for v1 (default 16 = Q:,
	  chosen to avoid colliding with CONF_PFS_TEST_DRIVE's own default
	  of 15/P:). Only the first virtio-9p device found on the
	  virtio-mmio transport is bound.

config CONF_VIRTIO_9P_MAX_DIRCACHE
	int "Cached directory listings for 8.3 short-name lookups"
	depends on CONF_WITH_VIRTIO_9P
	default 4
	range 1 32
	help
	  Fixed pool of cached directory listings, amortising the linear
	  Treaddir scan open()/rmdir()/remove()/rename()/lookup() otherwise
	  redo on every 8.3 short-name resolution. Cache-assisted, not
	  cache-required: a miss always falls back to the uncached scan, so
	  a low value only costs speed, never correctness.

config CONF_VIRTIO_9P_MAX_DIRCACHE_ENTRIES
	int "Cached entries per directory listing"
	depends on CONF_WITH_VIRTIO_9P
	default 64
	range 8 512
	help
	  A directory with more real entries than this falls back to the
	  uncached scan for that directory - see
	  CONF_VIRTIO_9P_MAX_DIRCACHE's own help text.

config CONF_WITH_FDC
	bool "Floppy disk controller support"
	depends on CONF_ATARI_HARDWARE && CONF_WITH_MFP && CONF_WITH_YM2149
	default y

config CONF_WITH_EJECT
	bool "Automatic floppy eject"
	depends on CONF_WITH_FDC
	default n

config CONF_WITH_XHDI
	bool "XHDI support"
	default n if TARGET_192 || TARGET_CART || MACHINE_RPI
	default y
	help
	  Provide the XHDI cookie and the XHDI entry point, which give
	  applications direct access to the mounted block devices.

config CONF_WITH_MONSTER
	bool "MonSTer expansion card support"
	depends on CONF_ATARI_HARDWARE
	default n if TARGET_192 || TARGET_CART || MACHINE_ARANYM || MACHINE_FIREBEE
	default y
	help
	  Detect and use the ST/STe MonSTer expansion card.

config HD_DETECT_RETRIES
	int "Retry count when probing for hard disks"
	default 0
	help
	  Setting this to a non-zero value is usually not necessary, and
	  increases the boot time by roughly (0.1 * retries * n) seconds,
	  where n is the number of devices that are not present.  It may
	  however help with misbehaving hardware.

endmenu

menu "PCI bus support"

config CONF_WITH_PCI
	bool "PCI bus support"
	depends on MACHINE_VIRT_ARM || TARGET_RPI4
	default y if MACHINE_VIRT_ARM
	default y if TARGET_RPI4
	help
	  Native pTOS PCI layer modeled on useful Atari PCI BIOS service
	  semantics. This provides discovery, configuration-space access,
	  resource reporting and card ownership through pTOS C APIs, not the
	  Atari _PCI cookie or function-table ABI.

config CONF_WITH_PCI_VIRT_ECAM
	bool
	depends on CONF_WITH_PCI && MACHINE_VIRT_ARM
	default y
	help
	  QEMU ARM virt generic ECAM PCIe backend.

config CONF_WITH_PCI_RPI4_BRCMSTB
	bool
	depends on CONF_WITH_PCI && TARGET_RPI4
	default y
	help
	  Raspberry Pi 4 BCM2711 PCIe host bridge backend.

endmenu

menu "Serial ports and console"

config CONF_WITH_MFP
	bool "MFP 68901 support"
	depends on CONF_ATARI_HARDWARE
	default y
	help
	  The Multi Function Peripheral provides the timers, the interrupt
	  controller, the parallel port and one of the serial ports of every
	  Atari machine except the FireBee.

config CONF_WITH_MFP_RS232
	bool "MFP RS-232 support"
	depends on CONF_WITH_MFP
	default y

config CONF_WITH_TT_MFP
	bool "TT MFP support"
	depends on CONF_ATARI_HARDWARE
	default n if TARGET_192 || TARGET_CART || MACHINE_ARANYM || MACHINE_FIREBEE
	default y

config CONF_WITH_SCC
	bool "SCC 85C30 support"
	depends on CONF_ATARI_HARDWARE
	default n if TARGET_192 || TARGET_CART || MACHINE_ARANYM || MACHINE_FIREBEE
	default y
	help
	  The Serial Communication Controller provides the serial ports of
	  the Mega STe, the TT and the Falcon.

config CONF_WITH_COLDFIRE_RS232
	bool "Internal ColdFire serial port"
	depends on ARCH_COLDFIRE
	default y

config CONF_WITH_RASPI_UART0
	bool "Raspberry Pi PL011 UART support"
	depends on MACHINE_RPI
	default y
	help
	  Use the PL011 UART available on the GPIO header as a serial port.

config CONF_WITH_VIRT_UART
	bool "QEMU virt (ARM) PL011 UART support"
	depends on MACHINE_VIRT_ARM
	default y
	help
	  Use the PL011 UART exposed by QEMU's ARM 'virt' machine as the
	  serial console.

config CONF_WITH_GOLDFISH_TTY
	bool "QEMU virt (m68k) Goldfish TTY support"
	depends on MACHINE_VIRT_M68K
	default y
	help
	  Use the Goldfish TTY device exposed by QEMU's m68k 'virt' machine
	  as the serial console.

config CONF_WITH_PRINTER_PORT
	bool "Parallel printer port support"
	depends on CONF_WITH_MFP
	default y

config CONF_WITH_MIDI_ACIA
	bool "MIDI ACIA support"
	depends on CONF_WITH_MFP
	default y

config CONF_WITH_IKBD_ACIA
	bool "IKBD ACIA support"
	depends on CONF_WITH_MFP
	default y
	help
	  The Intelligent Keyboard controller is attached to an ACIA 6850 on
	  every Atari machine.

config CONF_WITH_EXTENDED_MOUSE
	bool "Extended IKBD mouse packet support"
	depends on CONF_WITH_IKBD_ACIA
	default y
	help
	  Support the IKBD's extended mouse packet mode, giving finer mouse
	  resolution and pressure-sensitive-tablet style Z axis support.

config CONF_SERIAL_IKBD
	bool "IKBD devices on the serial port"
	default n
	help
	  Allow an IKBD keyboard, mouse or joystick to be plugged on the
	  serial port.

config CONF_SERIAL_CONSOLE
	bool "Use the serial port as the system console"
	default y if !CONF_WITH_ATARI_VIDEO && !MACHINE_AMIGA
	default n
	help
	  Send the console output to the serial port in addition to the
	  screen, and read the console input exclusively from the serial
	  port.  This is the only way to interact with a machine that has no
	  supported video hardware.

config CONF_SERIAL_CONSOLE_ANSI
	bool "The serial console understands ANSI escape sequences"
	depends on CONF_SERIAL_CONSOLE
	default y
	help
	  Say y if the terminal connected to the serial port uses ANSI
	  escape sequences.  Say n if it is an Atari VT52 terminal.

config CONF_WITH_FLEXCAN
	bool "FlexCAN controller support"
	depends on MACHINE_FIREBEE || MACHINE_M548X
	default y if MACHINE_M548X
	default n
	help
	  This allows an Eiffel keyboard adapter to be plugged on the CAN
	  port of ColdFire evaluation boards.

config CONF_WITH_VME
	bool "Mega STe VME bus support"
	depends on CONF_ATARI_HARDWARE
	default n if TARGET_192 || TARGET_CART || MACHINE_ARANYM
	default y

config CONF_WITH_DIP_SWITCHES
	bool "STe/TT/Falcon DIP switches support"
	depends on CONF_ATARI_HARDWARE
	default n if TARGET_192 || TARGET_CART
	default y

endmenu

menu "Video"

config CONF_WITH_ATARI_VIDEO
	bool "Atari video hardware support"
	depends on CONF_ATARI_HARDWARE
	default y
	help
	  Support for the ST Shifter and its successors.  Without this, the
	  system has no screen unless a graphics card is used.

config CONF_WITH_STE_SHIFTER
	bool "STe Shifter support"
	depends on CONF_WITH_ATARI_VIDEO
	default n if TARGET_192 || TARGET_CART || MACHINE_ARANYM || MACHINE_FIREBEE
	default y

config CONF_WITH_TT_SHIFTER
	bool "TT Shifter support"
	depends on CONF_WITH_ATARI_VIDEO
	default n if TARGET_192 || TARGET_CART || MACHINE_ARANYM || MACHINE_FIREBEE
	default y

config CONF_WITH_VIDEL
	bool "Falcon Videl support"
	depends on CONF_WITH_ATARI_VIDEO
	default n if TARGET_192 || TARGET_CART
	default y

config CONF_WITH_BLITTER
	bool "Blitter support"
	depends on CONF_ATARI_HARDWARE
	default n if MACHINE_FIREBEE
	default y

config CONF_WITH_NOVA
	bool "Nova graphics card support"
	depends on CONF_ATARI_HARDWARE
	default n if TARGET_192 || TARGET_CART || MACHINE_ARANYM || MACHINE_FIREBEE
	default y

config CONF_WITH_RASPI_VSYNC_IRQ
	bool "Raspberry Pi real vsync-driven VBL (SMI IRQ)"
	depends on MACHINE_RPI && !TARGET_RPI4
	default y
	help
	  Some Raspberry Pi GPU firmware builds support a legacy, otherwise
	  undocumented config.txt option ("fake_vsync_isr=1") that raises an
	  SMI interrupt synchronized to the real display refresh -- a
	  facility historically used by RISC OS on the BCM2835/36/37.  Say y
	  to let pTOS drive VBL from that interrupt when it is actually
	  arriving and validated as a real firmware-vblank event, instead of
	  always faking it off the 200 Hz system timer; VBL falls back to
	  the timer-driven 50 Hz automatically whenever the real interrupt
	  is absent, unvalidated or stops arriving.  See doc/readme-raspi.md
	  for the config.txt addition this depends on.

	  This is a runtime-detected capability, not a boot-time assumption,
	  which is why it defaults to y: pTOS does not require a config.txt
	  to boot or run, and the firmware option this looks for is opt-in,
	  so nothing about VBL timing changes unless fake_vsync_isr=1 is
	  also set in config.txt *and* the firmware actually raises a
	  validated vblank SMI.  Until then, and on any firmware that never
	  raises one, VBL keeps coming from the existing 200 Hz-derived
	  fallback exactly as before.  Whether current Raspberry Pi firmware
	  still provides this legacy mechanism at all has not yet been
	  verified on real Pi 1/2/3 hardware.

config CONF_VRAM_ADDRESS
	hex "Fixed video RAM address (0 = allocate in ST-RAM)"
	default 0x0
	help
	  Set the video RAM address to a fixed location, outside ST-RAM or
	  Alt-RAM.  This allows the use of custom graphics cards.  Set to 0
	  to allocate the video RAM in ST-RAM as usual.

endmenu

menu "Sound"

config CONF_WITH_YM2149
	bool "YM2149 soundchip support"
	depends on CONF_ATARI_HARDWARE
	default y
	help
	  Besides sound, the YM2149 provides the floppy drive selection and
	  the parallel port data lines.

config CONF_WITH_DMASOUND
	bool "STe/TT/Falcon DMA sound support"
	depends on CONF_ATARI_HARDWARE
	default n if TARGET_192 || TARGET_CART
	default y

config CONF_WITH_XBIOS_SOUND
	bool "Falcon XBIOS sound extension"
	depends on CONF_WITH_DMASOUND
	default n if TARGET_192
	default y
	help
	  Provide some of the Falcon XBIOS sound functions when running on
	  STe or TT compatible hardware.

endmenu

menu "Clock and NVRAM"

config CONF_WITH_IKBD_CLOCK
	bool "IKBD clock support"
	depends on CONF_ATARI_HARDWARE
	default n if MACHINE_ARANYM
	default y

config CONF_WITH_MEGARTC
	bool "Mega ST real-time clock support"
	depends on CONF_ATARI_HARDWARE
	default n if MACHINE_ARANYM || MACHINE_FIREBEE
	default y

config CONF_WITH_ICDRTC
	bool "ICD AdSCSI Plus ST real-time clock support"
	depends on CONF_WITH_ACSI
	default n if TARGET_192 || TARGET_CART || MACHINE_FIREBEE
	default y
	help
	  Support for the real-time clock on the ICD AdSCSI Plus ST board,
	  which is attached via the ACSI interface.  It is useless on the
	  FireBee, which has an NVRAM clock.

config CONF_WITH_NVRAM
	bool "NVRAM support"
	depends on CONF_ATARI_HARDWARE
	default n if TARGET_192 || TARGET_CART
	default y

config CONF_WITH_ULTRASATAN_CLOCK
	bool "UltraSatan real-time clock support"
	depends on CONF_WITH_ACSI
	default y
	help
	  Support for the real-time clock on the UltraSatan ACSI hard disk
	  interface.  Useless on the FireBee, which has its own NVRAM clock.

config CONF_WITH_BOOTARGS_LANG
	bool "Boot command line language/keyboard override"
	depends on MACHINE_RPI || MACHINE_VIRT_ARM
	default y
	help
	  These machines have no NVRAM (see CONF_WITH_NVRAM) to store the
	  country/keyboard setting a multi-language image picks at run
	  time.  Say y to read it instead from a "ptos.lang=xx" parameter
	  on the ARM boot loader's command line, where xx is one of the
	  two-letter country codes listed in country.mk (e.g. "de", "fr",
	  "uk").  On the Raspberry Pi, set this in cmdline.txt.  Under QEMU,
	  use -append "ptos.lang=xx" when the chosen loader actually passes bootargs
	  (see doc/country.txt).  Only takes effect on a
	  multi-language image (say n to BUILD_UNIQUE_COUNTRY); with no
	  matching parameter, or on a single-country image, the country
	  baked in at build time is used as before.

endmenu

menu "Miscellaneous BIOS features"

config CONF_COLDFIRE_TIMER_C
	bool "Simulate Timer C with an internal ColdFire timer"
	depends on ARCH_COLDFIRE && !CONF_WITH_MFP
	default y
	help
	  The 200 Hz system timer is normally provided by the MFP.  On a
	  ColdFire board without MFP it has to be simulated using one of the
	  general purpose timers of the processor.

config CONF_RASPI_TIMER_C
	bool "Simulate Timer C with an ARM timer"
	depends on MACHINE_RPI
	default y
	help
	  The 200 Hz system timer is provided by one of the ARM side timers
	  of the BCM283x SoC.

config CONF_WITH_CARTRIDGE
	bool "ROM port cartridge support"
	depends on CONF_ATARI_HARDWARE && !DIAGNOSTIC_CARTRIDGE
	default n if MACHINE_ARANYM
	default y
	help
	  Run the application cartridge plugged in the ROM port, if any.
	  Diagnostic and application cartridges have different magic
	  numbers, so a diagnostic cartridge can not also be an application
	  cartridge.

config CONF_WITH_SFP004
	bool "Mega ST SFP004 FPU support"
	depends on CONF_ATARI_HARDWARE
	default n if MACHINE_ARANYM || MACHINE_FIREBEE
	default y

config CONF_WITH_DSP
	bool "Falcon DSP support"
	depends on CONF_WITH_VIDEL
	default n if MACHINE_FIREBEE
	default y
	help
	  Support for the Falcon's Motorola 56001 DSP, detected and used by
	  Xbios DSP calls.

config CONF_WITH_BIOS_EXTENSIONS
	bool "BIOS extension functions"
	default n if TARGET_192 || TARGET_CART
	default y

config CONF_WITH_SHUTDOWN
	bool "Shutdown support"
	default n if TARGET_192 || TARGET_CART
	default y if DETECT_NATIVE_FEATURES || MACHINE_FIREBEE || MACHINE_AMIGA
	default n
	help
	  Enable the shutdown() function, which tries to power off the
	  machine when that is possible.

config USE_STATIC_INLINES
	bool "Use static inline functions"
	depends on !ARCH_ARM
	default y
	help
	  Compile some very small functions as static inlines.  This makes
	  the code both smaller and faster on any reasonably modern
	  compiler.

endmenu
```
