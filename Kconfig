## aes/Kconfig
```kconfig
#
# aes/Kconfig - AES options
#
# Copyright (C) 2001-2017 The EmuTOS development team.
#
# This file is distributed under the GPL, version 2 or at your
# option any later version.  See doc/license.txt for details.
#

menu "AES"

config CONF_WITH_AES
	bool "Include the AES and the EmuDesk desktop"
	default n if TARGET_CART
	default y
	help
	  Without the AES there is no graphical desktop; EmuTOS boots
	  straight into EmuCON or runs the program found on the boot device.
	  This is only useful when the image size is severely restricted,
	  such as for the diagnostic cartridge.

if CONF_WITH_AES

config AES_STACK_SIZE
	int "Size of the private AES stack, in LONGs"
	default 2048 if MACHINE_FIREBEE || MACHINE_M548X
	default 590
	help
	  Size of the private stack of each AES process.  It is used for the
	  AES itself, including every call it makes to the VDI, the BIOS and
	  GEMDOS.

	  An application that calls v_gtext() via a USERDEF and links to
	  Gemlib needs a large AES stack, because Gemlib's v_gtext() puts a
	  1024-word buffer on the stack.  This is principally a problem when
	  recompiling for ColdFire systems, hence the larger default there.

	  A suitable value can be estimated by enabling CONF_DEBUG_AES_STACK.

config CONF_WITH_PCGEM
	bool "PC-GEM compatible AES functions"
	default n if TARGET_192
	default y

config CONF_WITH_LOADABLE_CURSORS
	bool "Loadable mouse cursors"
	default y
	help
	  Allow the mouse cursors to be loaded from A:\EMUCURS.RSC instead
	  of using the built-in ones.

config CONF_WITH_COLOUR_ICONS
	bool "Colour icons"
	default n if TARGET_192 || TARGET_CART
	default y
	help
	  Recognise 'new format' RSC files and render the CICONBLK colour
	  icon data they may contain, as in Atari TOS 4.  Resources without
	  colour icon data, and legacy mono ICONBLK icons, are unaffected.

	  Space is tight on the smallest ROM targets, so this is disabled
	  by default there.

config CONF_WITH_LEGACY_RSC_LOAD
	bool "Use legacy resource loader"
	depends on ARCH_M68K
	default y if TARGET_192
	default n
	help
	  Use the former in-place resource loader instead of the portable
	  canonical resource loader.  It relies on the m68k native structure
	  layout matching Atari's big-endian resource-file layout.

	  The 192 KB ROM enables this by default because its ROM budget cannot
	  accommodate the portable loader.  Other m68k images should normally
	  use the portable loader, but may select this option when space is
	  more important than the portable loader's canonical decoding and
	  validation.

config CONF_WITH_NICELINES
	bool "Menu nicelines"
	default y
	help
	  Draw menu separator lines with the VDI instead of rendering the
	  traditional disabled dash string.

endif

endmenu
```

## bdos/Kconfig
```kconfig
#
# bdos/Kconfig - GEMDOS options
#
# Copyright (C) 2025-2026 The pTOS development team.
#
# This file is distributed under the GPL, version 2 or at your
# option any later version.  See doc/license.txt for details.
#

menu "GEMDOS (BDOS)"

config CONF_LOGSEC_SIZE
	int "Maximum logical sector size, in bytes"
	default 512
	range 512 16384
	help
	  Maximum size of the logical sectors GEMDOS can handle.  If a
	  larger value is found on a mounted drive during startup, that
	  value is used instead.  The value must be a power of two between
	  512 and 16384 inclusive.

	  This is only significant for Atari style FAT filesystems; DOS
	  style FAT filesystems always use 512 byte logical sectors.

config CONF_PREFER_STRAM_DISK_BUFFERS
	bool "Allocate the disk buffers in ST-RAM"
	default y if CONF_ATARI_HARDWARE
	default n
	help
	  Say y when disk buffers are more efficient in ST-RAM, which is the
	  case whenever floppy or ACSI DMA transfers are used.

config CONF_WITH_ELF_LOADER
	bool "Load ELF executables"
	default y if ARCH_ARM || ARCH_X86_64
	default n
	help
	  Add a second, ELF based executable loader alongside the classic
	  Atari GEMDOS PRG format.  Pexec() picks the loader by inspecting the
	  file's magic number, so both formats can coexist.

	  The program must be a statically linked ELF for this machine, in one
	  of two forms:

	    * a fixed base ET_EXEC linked with "ld --emit-relocs" (ld -q),
	      which keeps its relocation entries in the binary, or
	    * a position independent ET_DYN (PIE, "ld -pie
	      --no-dynamic-linker").

	  The loader places the PT_LOAD segments in the TPA and applies the
	  retained relocation entries, exactly like the PRG loader applies its
	  own relocation table.  It reads the relocations from the section
	  headers, so the binary must keep them (do not strip it).

	  On x86-64 (#334) this is the ELFCLASS32/EM_X86_64 x32 psABI, not
	  IA-32/EM_386 compat-mode code -- see tests/x32_hello/x32_hello.c.

	  This is enabled by default on ARM and x86-64, neither of which can
	  produce the m68k specific PRG format at all, and is available on
	  m68k as an alternative to PRG.

config CONF_WITH_PTOS_ABI_IMPORTS
	bool "Native pTOS ABI imports for ELF executables"
	depends on CONF_WITH_ELF_LOADER
	default n
	help
	  Let a native ELF executable import pTOS system functions as ordinary
	  typed C function calls, resolved by Pexec() against a kernel-side
	  export table instead of requiring the caller to build a TRAP #1
	  parameter block by hand. See doc/elfload.txt's "Native pTOS ABI
	  imports" section for the .ptos.imports/.ptos.bind ELF metadata format
	  and bdos/elfld.c's resolution mechanism this enables.

	  CONF_WITH_X32_VDI selects this and registers vdi:vdi, ABI 1.0, for
	  x32 programs. That entry executes in a read-only user client image
	  mapped privately into each process, with narrow syscalls for hardware
	  access. No LP64 kernel code or data address is bound into x32 code.
	  CONF_WITH_X32_AES adds the typed aes: client exports. Other
	  namespaces, including the retired gemdos imports, are refused.

config CONF_WITH_USER_CALLBACKS
	bool "Typed callbacks on x32 user stacks"
	depends on ARCH_X86_64 && CONF_WITH_USER_ASPACE && CONF_WITH_KHEAP
	default y if CONF_WITH_X32_VDI
	help
	  Process-owned callback registrations, authenticated return/chaining
	  stubs, alternate stacks and bounded nested ring-3 delivery. The
	  legacy m68k and ARM callback conventions are unchanged.

config CONF_WITH_KPROC
	bool "Kernel-private process records" if !ARCH_X86_64
	default y if ARCH_X86_64
	default n
	help
	  Keep a kernel-owned record per process (struct kproc, bdos/kproc.c)
	  beside the public GEMDOS basepage, so state the kernel must be able
	  to trust never has to live in memory the process can write: the
	  launching process (used by Pterm() instead of the basepage's p_parent),
	  whether the process was launched, its DTA pointer, and its standard
	  handle map and current directories, which are then no longer read
	  from or written to the basepage's p_uft and p_curdir fields (as in
	  FreeMiNT).

	  Mandatory on x86-64, where ring-3 processes can write their whole
	  basepage and the record is load-bearing.  On other architectures it
	  is optional and off by default: nothing there protects the kernel
	  from a program anyway, and programs that look at p_uft/p_curdir of
	  their basepage see zeros when it is on.  Turn it on to exercise the
	  same code the x86-64 port runs.

config CONF_WITH_PROCMEM
	bool
	select CONF_WITH_KPROC
	help
	  The memory blocks of a process (its basepage with the TPA, and its
	  environment) come from a window of kernel memory managed by
	  include/procmem.h instead of from the GEMDOS memory descriptor lists:
	  every block has an owner, a generation and a pin count, so that a
	  stale or foreign address is recognised, and the blocks are reachable
	  by a 32-bit address (on x86-64, while the kernel itself is 64-bit).
	  Not user-selectable: CONF_WITH_USER_ASPACE, which needs it, sets it.

config CONF_WITH_USER_ASPACE
	bool
	default y if ARCH_HAS_USER_ASPACE
	select CONF_WITH_PROCMEM
	select CONF_WITH_KHEAP
	select CONF_WITH_KPROC
	select CONF_WITH_USER_COPY
	help
	  Processes run in user mode in per-process address spaces (ring 3
	  on x86-64; doc/x86_64-address-space.txt, doc/mmu-address-space.txt):
	  the record also carries the process's page tables, kernel stack,
	  memory-block identities and loans, and its read-only copies of its
	  ancestors' basepages, and the DTA pointer in it is the only one
	  trusted.  Not user-selectable: it is on where the architecture has
	  an address-space backend (ARCH_HAS_USER_ASPACE, include/procmem.h),
	  and requires CONF_WITH_KPROC.

config CONF_WITH_DEMAND_PAGING
	bool "Back user memory when it is first touched"
	depends on CONF_WITH_USER_ASPACE && ARCH_HAS_DEMAND_PAGING
	default y
	help
	  A process's stack and Malloc() blocks are address space until it
	  touches them: the page fault handler gives each page its zeroed
	  physical page then, so untouched memory costs nothing and the
	  default stack can be 16 MiB.  Without it every page is mapped when
	  the memory is handed out, and the default stack is 256 KiB.
	  Offered where the address-space backend can do it
	  (ARCH_HAS_DEMAND_PAGING); turn it off to run the eager path a
	  backend without it uses.

config CONF_WITH_FAT_FILE_LIFETIMES
	bool "Extended native FAT file lifetimes"
	default n if TARGET_192
	default y
	help
	  Keep deleted files alive until their last open handle or backing
	  reference is released. Retain and retry interrupted name removal
	  and FAT-chain reclamation without reallocating pending clusters.
	  Disable for small ROMs to use traditional GEMDOS deletion: files
	  open by another process cannot be deleted, and this process's open
	  files are closed before their clusters are freed. File mappings
	  require the extended implementation.

config CONF_WITH_FILE_PINS
	bool
	select CONF_WITH_FAT_FILE_LIFETIMES
	help
	  Retain native file backing independently of GEMDOS handles. Selected
	  by file mappings and by their lifetime self-tests; ordinary unlink
	  lifetime support does not require this internal kernel entry point.

config CONF_WITH_MMAP
	bool "Private anonymous and file-backed process mappings"
	depends on CONF_WITH_USER_ASPACE && CONF_WITH_DEMAND_PAGING
	select CONF_WITH_FILE_PINS
	default n
	help
	  Provide Mmap, Munmap and Mprot for private anonymous and native FAT
	  file pages in a separate per-process window. File pages are shared
	  read-only until a private write fault; anonymous pages stay lazy zero.
	  Enforce W^X, lifetime and memory limits. MAP_SHARED and replacing
	  MAP_FIXED are not supported.  Needs isolated MMU address spaces
	  with demand paging: x32, and the 32-bit ARM and m68k backends.

config CONF_WITH_ELF_SHARED
	bool "Experimental userspace ELF shared-library linker core"
	depends on CONF_WITH_ELF_LOADER && CONF_WITH_USER_ASPACE
	depends on ARCH_X86_64 || ARCH_ARM || ARCH_M68K
	depends on CONF_WITH_DEMAND_PAGING
	select CONF_WITH_MMAP
	default n
	help
	  Build the freestanding userspace linker core for standard ELF shared
	  objects.  Requires isolated, MMU-backed process address spaces: x32
	  and ARM (hard-float EABI, ARM state) have the backends, and the 68040
	  address-space configurations (built with a PIC-capable m68k compiler).

	  Includes a freestanding ld.so and a separate dynamic CRT/client subset.
	  Private mapping/protection services use Mmap, Munmap and Mprot; interpreter
	  handoff and a private argc/argv/envp/auxv stack are implemented and tested.
	  Eager x32 relocation and dependency discovery are available in the core.
	  DSO pages use retained file-backed private mappings and write-fault COW.
	  A complete shared libcmini and advanced ELF features remain separate.
	  Static ELF and classic PRG loading are unchanged.
	  The core is built separately from the kernel, in obj/ldso/.

config CONF_WITH_KHEAP
	bool
	help
	  A growable heap for kernel-only objects (include/kheap.h):
	  kernel-private process records (struct kproc) and address-space
	  metadata come from it instead of the fixed GEMDOS memory descriptor
	  pool, so their number is bounded by memory, not by that pool.  The
	  machine provides it.  Not user-selectable: CONF_WITH_USER_ASPACE,
	  which needs it, sets it.

config CONF_WITH_KCALL
	bool
	default y if ARCH_X86_64
	default y if CONF_WITH_USER_ASPACE
	help
	  Kernel code calls GEMDOS functions as plain C calls to their
	  implementations (bdos/kcall.c) instead of through a
	  trap, because the trap path belongs to the processes.  Only the
	  calls kernel code makes exist.  Not user-selectable: it follows
	  the architecture.

config CONF_WITH_SSYSTEM
	bool
	default y if ARCH_ARM || ARCH_X86_64
	default y if CONF_WITH_USER_ASPACE
	help
	  Ssystem() (GEMDOS 0x154, bdos/ssystem.c) is written in C and
	  dispatched from osif(); on the other architectures it is handled by
	  the assembly trap entry.  Not user-selectable: it follows the
	  architecture, and the options that need it (the desktop as a
	  program, CONF_EXTERNAL_DESK, which asks the kernel what it used to
	  read from its variables) select it on m68k.

config CONF_WITH_GEMDOS_SHUTDOWN
	bool "Shutdown() GEMDOS call"
	default n if TARGET_192 || TARGET_256 || TARGET_CART
	default y
	help
	  Add GEMDOS Shutdown() (0x151, as in MiNT and MagiC): close all files,
	  write out the disk buffers, then power off, restart or halt.  Where
	  the machine has no software power-off or reset (the Atari ST and
	  its relatives have no power-off at all) it ends in the "safe to turn
	  off your computer" message instead.  Off by default for the ROM
	  images that have no room left (192 KB, 256 KB, the cartridge).
	  The power off is what
	  CONF_WITH_SHUTDOWN (bios/Kconfig) provides where that is set.

config CONF_WITH_USER_COPY
	bool "Validate the pointers passed to GEMDOS calls" if !ARCH_X86_64 && CONF_WITH_KPROC
	default y if ARCH_X86_64
	default n
	help
	  Check the pointer arguments of every GEMDOS (trap 1) call against the
	  calling process before the call runs (bdos/uaccess.c): each pointer a
	  call really uses must lie in memory the process may read, or write for
	  an output, for its whole length, with no wrap-around, and strings must
	  end within a bound.  A bad pointer makes the call fail with EIMBA
	  (ERANGE for a bad length) instead of the kernel dereferencing it.
	  Arguments a call does not use are never looked at.

	  Mandatory on x86-64, where the kernel runs under the calling
	  process's page tables and would otherwise touch the system variables
	  or another block through a pointer it was handed.  Optional and off by
	  default elsewhere (on m68k the packed argument frame of the trap is
	  first unpacked into one value per argument, in bdos/bdosmain.c);
	  without per-process address spaces the checks only look for null
	  pointers and bad lengths.  Other call classes (BIOS,
	  XBIOS, VDI, AES) are guarded by the same option as they are converted.

config CONF_WITH_PRG_LOADER
	bool "Load classic Atari GEMDOS PRG executables"
	depends on ARCH_M68K
	default y
	help
	  Recognize and load the classic Atari GEMDOS PRG executable format
	  (magic 0x601a) in Pexec().  A PRG's TEXT segment is raw m68k machine
	  code with an m68k specific relocation table; loading one just places
	  those bytes in the TPA and jumps in, with no check that the CPU
	  running Pexec() can execute them. That is only meaningful where the
	  file can only ever contain m68k code, so this is restricted to m68k
	  targets - a non-m68k machine must not go looking for, and jumping
	  into, code in a foreign instruction set. Non-m68k targets rely on
	  CONF_WITH_ELF_LOADER instead.

endmenu
```
