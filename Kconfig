## Kconfig.debug
```kconfig
#
# Kconfig.debug - diagnostics and debugging
#
# Copyright (C) 2001-2017 The EmuTOS development team.
#
# This file is distributed under the GPL, version 2 or at your
# option any later version.  See doc/license.txt for details.
#

menu "Startup screen"

config FULL_INITINFO
	bool "Full welcome screen"
	default n if TARGET_192
	default y
	help
	  Say n to display the EmuTOS version as a single line of text
	  instead of the full welcome screen.  This is only useful when
	  there are severe image size restrictions.

config ALWAYS_SHOW_INITINFO
	bool "Show the welcome screen on warm boot too"
	default y if MACHINE_M548X || MACHINE_RPI
	default n
	help
	  By default the welcome screen is only shown on cold boot.  Say y
	  to display it on both cold boot and warm boot (reset).

config INITINFO_DURATION
	int "Duration of the welcome screen, in seconds"
	default 8 if MACHINE_FIREBEE
	default 3
	help
	  On emulators, three seconds is enough to read the text and
	  optionally to press Shift to keep the screen displayed.  On real
	  hardware it can take several seconds for the monitor to recover
	  from stand-by mode, so a longer duration is wise.  If set to 0,
	  the welcome screen is never displayed.

endmenu

menu "Debugging"

choice
	prompt "Debug output channel"
	default DEBUG_PRINT_NONE
	help
	  Where kprintf() and the KDEBUG() traces are sent.  Only one
	  channel can be active at a time.

config DEBUG_PRINT_NONE
	bool "None (or native features only)"
	help
	  Debug output is discarded, unless the emulator provides a native
	  print function, in which case that is used.

config DEBUG_PRINT_CONSOLE
	bool "BIOS console"

config DEBUG_PRINT_RS232
	bool "MFP RS-232 or Raspberry Pi UART"
	help
	  Useful for an emulator without any native debug print capability,
	  and for real hardware.

config DEBUG_PRINT_SCC
	bool "SCC port B"
	depends on CONF_WITH_SCC
	help
	  Primarily for use with real Falcon hardware, which does not use
	  the MFP USART.

config DEBUG_PRINT_COLDFIRE
	bool "ColdFire serial port"
	depends on CONF_WITH_COLDFIRE_RS232

config DEBUG_PRINT_MIDI
	bool "MIDI out"
	depends on CONF_WITH_MIDI_ACIA

config DEBUG_PRINT_CARTRIDGE
	bool "Cartridge debug port"
	depends on ARCH_M68K_CLASSIC
	help
	  Send debug output through the Atari cartridge ROM debug interface.

endchoice

#
# Derived symbols matching the macros used by the sources.  The choice
# above guarantees that at most one of them is set.
#

config CONSOLE_DEBUG_PRINT
	bool
	default y if DEBUG_PRINT_CONSOLE

config RS232_DEBUG_PRINT
	bool
	default y if DEBUG_PRINT_RS232
	default y if DEBUG_PRINT_NONE && CONF_SERIAL_CONSOLE && !CONF_WITH_COLDFIRE_RS232

config SCC_DEBUG_PRINT
	bool
	default y if DEBUG_PRINT_SCC

config COLDFIRE_DEBUG_PRINT
	bool
	default y if DEBUG_PRINT_COLDFIRE
	default y if DEBUG_PRINT_NONE && CONF_SERIAL_CONSOLE && CONF_WITH_COLDFIRE_RS232

config MIDI_DEBUG_PRINT
	bool
	default y if DEBUG_PRINT_MIDI

config CARTRIDGE_DEBUG_PRINT
	bool
	default y if DEBUG_PRINT_CARTRIDGE

config CONF_WITH_ASSERT
	bool "Enable the assert() function"
	default n if TARGET_192 || TARGET_CART
	default y

config CONF_DEBUG_AES_STACK
	bool "Trace the AES stack usage"
	depends on CONF_WITH_AES
	default n
	help
	  Trace the internal AES stack usage in order to estimate a suitable
	  value for AES_STACK_SIZE.

config CONF_DEBUG_DESK_STACK
	bool "Monitor the desktop stack usage"
	depends on CONF_WITH_AES
	default n

source "tests/Kconfig"

endmenu
```

## Kconfig.i18n
```kconfig
#
# Kconfig.i18n - country and language selection
#
# Copyright (C) 2001-2017 The EmuTOS development team.
#
# This file is distributed under the GPL, version 2 or at your
# option any later version.  See doc/license.txt for details.
#
# The country codes below must match the table in country.mk, which also
# defines the language, keyboard layout, charset and date/time format used
# for each of them.
#

menu "Localization"

choice
	prompt "Country"
	default BUILD_COUNTRY_US
	help
	  The country the image is built for.  It selects the keyboard
	  layout, the character set, the date and time format and, unless a
	  multi-language image is built, the language of all messages.

config BUILD_COUNTRY_US
	bool "United States"
config BUILD_COUNTRY_DE
	bool "Germany"
config BUILD_COUNTRY_FR
	bool "France"
config BUILD_COUNTRY_CZ
	bool "Czech Republic"
config BUILD_COUNTRY_GR
	bool "Greece"
config BUILD_COUNTRY_ES
	bool "Spain"
config BUILD_COUNTRY_FI
	bool "Finland"
config BUILD_COUNTRY_SG
	bool "Switzerland (German)"
config BUILD_COUNTRY_RU
	bool "Russia"
config BUILD_COUNTRY_IT
	bool "Italy"
config BUILD_COUNTRY_UK
	bool "United Kingdom"
config BUILD_COUNTRY_NO
	bool "Norway"
config BUILD_COUNTRY_SE
	bool "Sweden"

endchoice

config BUILD_COUNTRY
	string
	default "us" if BUILD_COUNTRY_US
	default "de" if BUILD_COUNTRY_DE
	default "fr" if BUILD_COUNTRY_FR
	default "cz" if BUILD_COUNTRY_CZ
	default "gr" if BUILD_COUNTRY_GR
	default "es" if BUILD_COUNTRY_ES
	default "fi" if BUILD_COUNTRY_FI
	default "sg" if BUILD_COUNTRY_SG
	default "ru" if BUILD_COUNTRY_RU
	default "it" if BUILD_COUNTRY_IT
	default "uk" if BUILD_COUNTRY_UK
	default "no" if BUILD_COUNTRY_NO
	default "se" if BUILD_COUNTRY_SE

config BUILD_UNIQUE_COUNTRY
	bool "Build a single-country image"
	default y
	help
	  Say y to build an image supporting only the country selected
	  above.  All messages are translated at build time and only the
	  fonts of the matching charset are included, which saves a large
	  amount of ROM space.

	  Say n to build a multi-language image, where the language is
	  picked at boot time from the NVRAM or from the country code stored
	  in the OS header.

endmenu
```

## Kconfig.image
```kconfig
#
# Kconfig.image - boot image format and OS identification
#
# Copyright (C) 2001-2017 The EmuTOS development team.
#
# This file is distributed under the GPL, version 2 or at your
# option any later version.  See doc/license.txt for details.
#

menu "Boot image"

choice
	prompt "Image type"
	default TARGET_RPI_KERNEL if MACHINE_RPI
	default TARGET_AMIGA_ROM if MACHINE_AMIGA
	default TARGET_SREC if ARCH_COLDFIRE
	default TARGET_512 if MACHINE_ARANYM
	default TARGET_VIRT_M68K_KERNEL if MACHINE_VIRT_M68K
	default TARGET_256
	help
	  Select what the build should produce.  Only the image types that
	  make sense for the selected machine are offered.

config TARGET_192
	bool "Atari ROM image, 192 KB"
	depends on CONF_ATARI_HARDWARE && !ARCH_COLDFIRE
	help
	  A 192 KB ROM image, mapped at 0x00fc0000, for machines with the
	  original two 96 KB ROM sockets.  Space is very tight, so most of
	  the optional features are disabled by default.

config TARGET_256
	bool "Atari ROM image, 256 KB"
	depends on CONF_ATARI_HARDWARE && !ARCH_COLDFIRE
	help
	  A 256 KB ROM image, mapped at 0x00e00000.  This is the usual
	  choice for ST/STe hardware and for Hatari.

config TARGET_512
	bool "Atari ROM image, 512 KB"
	depends on CONF_ATARI_HARDWARE && !ARCH_COLDFIRE
	help
	  A 512 KB ROM image, mapped at 0x00e00000.  This is the full
	  featured image, suitable for the TT, the Falcon and ARAnyM.

config TARGET_CART
	bool "Atari diagnostic cartridge image, 128 KB"
	depends on CONF_ATARI_HARDWARE && !ARCH_COLDFIRE
	help
	  A diagnostic cartridge image, mapped at 0x00fa0000.  It is limited
	  to 128 KB, so the AES and the desktop cannot be included.

config TARGET_PRG
	bool "Atari RAM TOS program (emutos.prg)"
	depends on ARCH_M68K
	help
	  A regular Atari program that replaces the TOS in RAM when run from
	  an existing TOS.

config TARGET_FLOPPY
	bool "Atari bootable floppy image (.st)"
	depends on CONF_ATARI_HARDWARE && !ARCH_COLDFIRE
	help
	  A bootable floppy image containing a RAM TOS and a boot sector
	  that loads it.

config TARGET_SREC
	bool "Motorola S-record image (.s19)"
	depends on ARCH_COLDFIRE
	help
	  An S-record image to be loaded by the dBUG monitor or flashed on a
	  ColdFire board.

config TARGET_AMIGA_ROM
	bool "Amiga ROM image"
	depends on MACHINE_AMIGA

config TARGET_AMIGA_KICKDISK
	bool "Amiga 1000 Kickstart disk (.adf)"
	depends on MACHINE_AMIGA
	help
	  An Amiga ROM image wrapped in a Kickstart floppy image, for the
	  Amiga 1000.

config TARGET_AMIGA_FLOPPY
	bool "Amiga bootable floppy image (.adf)"
	depends on MACHINE_AMIGA

config TARGET_RPI_KERNEL
	bool "Raspberry Pi kernel image"
	depends on MACHINE_RPI
	help
	  A flat binary kernel image to be copied on the boot partition of
	  the SD card.  The file name expected by the firmware depends on
	  the Raspberry Pi model and is chosen automatically.

config TARGET_VIRT_ARM_KERNEL
	bool "QEMU virt (ARM) kernel image"
	depends on MACHINE_VIRT_ARM
	help
	  An ELF image passed directly to "qemu-system-arm -M virt -kernel".
	  Unlike the Raspberry Pi kernel image, this is not converted to a
	  flat binary: QEMU's ELF loader is used directly, so the entry
	  point and load addresses come from the ELF header.

config TARGET_VIRT_M68K_KERNEL
	bool "QEMU virt (m68k) kernel image"
	depends on MACHINE_VIRT_M68K
	help
	  An ELF image passed directly to "qemu-system-m68k -M virt -kernel".
	  Like the ARM virt kernel image, this is not converted to a flat
	  binary: QEMU's ELF loader is used directly.

endchoice

config SREC_LMA
	hex "Load address of the S-record image"
	depends on TARGET_SREC
	default 0xe0600000 if MACHINE_FIREBEE
	default 0xe0100000 if CONF_WITH_BAS_MEMORY_MAP
	default 0x00e00000
	help
	  Address the S-record image is loaded at.  Use 0x00e00000 for the
	  dBUG monitor and 0xe0100000 for BaS_gcc on an M548x board.

config IMAGE_NAME
	string "Name of the generated image file"
	default ""
	help
	  Override the name of the file produced by the build.  Leave it
	  empty to let the build system derive a name from the image type
	  and, where relevant, from the selected country.

#
# Derived symbols.  EMUTOS_LIVES_IN_RAM tells the rest of the system that
# the image is loaded into RAM instead of being mapped from ROM.
#

config EMUTOS_LIVES_IN_RAM
	bool
	default y if TARGET_PRG || TARGET_FLOPPY || TARGET_AMIGA_FLOPPY || TARGET_RPI_KERNEL || TARGET_VIRT_ARM_KERNEL || TARGET_VIRT_M68K_KERNEL

config DIAGNOSTIC_CARTRIDGE
	bool
	default y if TARGET_CART

config CONF_WITH_BOOT_SECTOR
	bool "Execute the boot sector of the boot device"
	depends on ARCH_M68K
	default y
	help
	  Load and run the boot sector of the boot device.  This is required
	  to boot from a floppy or from a hard disk driver.

	  The boot sector format is an Atari/m68k convention: a sector whose
	  words sum to a magic checksum is jumped into directly, with no
	  further check that its contents are actually machine code for the
	  running CPU.  That is only safe where the boot sector can only ever
	  contain m68k code, so this is restricted to m68k targets - a
	  non-m68k machine must not go looking for, and jumping into, code in
	  a foreign instruction set.

config CONF_WITH_RESET
	bool "Execute the reset instruction during startup"
	depends on ARCH_M68K_CLASSIC
	default n if EMUTOS_LIVES_IN_RAM
	default y
	help
	  Say n to bypass the "reset" instruction during startup.  It is
	  bypassed by default in EmuTOS RAM, because it causes crashes very
	  early in startup (the "black screen" problem).  It is surmised that
	  the hardware reset may reset the RAM controller, allowing or
	  causing RAM contents to change.

endmenu

menu "OS identification"

config TOS_VERSION
	hex "TOS version reported by the OS header"
	default 0x104 if TARGET_192
	default 0x206
	range 0x100 0xffff
	help
	  This is just a version number; the features of EmuTOS are not
	  affected.  Note that some software checks for a TOS version below
	  1.06 to determine that the ROM is located at 0x00fc0000, which is
	  why the 192 KB image reports 1.04.

config GEMDOS_VERSION
	hex "GEMDOS version returned by Sversion()"
	default 0x2000
	help
	  The value contains the minor version number in the high-order byte
	  and the major version number in the low-order byte.  Useful values
	  are 0x1300 (TOS 1.0), 0x1500 (TOS 1.04), 0x1700 (TOS 1.62),
	  0x1900 (TOS 2.01), 0x2000 (TOS 2.06) and 0x3000 (TOS 4.0x).

config AES_VERSION
	hex "AES version returned by appl_init()"
	default 0x0140
	help
	  Useful values are 0x0120 (TOS 1.02), 0x0140 (TOS 1.04 and 1.62),
	  0x0320 (TOS 2.06 and 3.06) and 0x0340 (TOS 4.04).  Do not change
	  this arbitrarily, as each value implies the presence or absence of
	  certain AES functions.

endmenu
```
