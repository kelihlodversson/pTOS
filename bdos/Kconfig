## tests/Kconfig
```kconfig
menu "Regression tests"

# The supervisor-side fixture of the MMU tests (#737): Ssystem(S_MMUPROBE)
# reads the MMU and tests a translation for the caller.
config CONF_WITH_MMU_PROBE
    bool
    default y if CONF_WITH_REGRESSION_TESTS && ARCH_M68K_CLASSIC && CONF_WITH_ADVANCED_CPU && CONF_WITH_HIGHER_HALF
    select CONF_WITH_SSYSTEM

config CONF_WITH_REGRESSION_TESTS
    bool "Include built-in regression tests"
    default y
    help
      Build the regression test harness into a separate HD image.
      When enabled, 'make test-hd' produces a raw disk image that
      boots pTOS and runs the test suite automatically.

config CONF_WITH_X86_64_MEMTEST
    bool "Run the x86-64 memory-management self-test at boot"
    depends on MACHINE_PC_X86_64
    select CONF_WITH_FILE_PINS
    default y
    help
      At every boot, exercise the tracked process allocations, the
      growable kernel heap, per-process address spaces and KPROC records
      with repeated create/exit and injected-failure cycles, and check that
      none of them leaks (bios/machine/pc-x86_64/memtest.c).  The result is
      one line on the console, "x86-64 memtest: PASS" or "FAIL (n)", which
      the CI boot test looks for.  It takes a fraction of a second.

config CONF_WITH_X32_DESKTOP_TEST
    bool "Report external x32 desktop integration checkpoints"
    depends on ARCH_X86_64 && CONF_EXTERNAL_DESK && CONF_WITH_USER_CALLBACKS
    depends on CONF_WITH_READ_INF && CONF_WITH_CLI
    default n
    help
      Emit serial-only markers from the real desktop for the QEMU PS/2
      integration driver, including CPL, menus, forms and USERDEF drawing.
      Console return and missing-desktop fallback support both external
      and embedded EmuCON.

config CONF_WITH_CUIS_WAIT_TEST
    bool "Observe native CUIS wait admission in regression tests"
    depends on CONF_WITH_REGRESSION_TESTS && CONF_WITH_CUIS && CONF_WITH_PCLONE && CONF_WITH_PTERMGRP && CONF_WITH_PTHJOIN
    default y if CONF_WITH_PRIVATE_CLONE_TEST
    help
      Let regression peers observe their own PROCESS's blocked wait before
      the host injects real input. This uses a private Pclone test selector.

config CONF_WITH_IRQ_RESTART_TEST
    bool "Test retained hardware user interruption across another THREAD"
    depends on CONF_WITH_NATIVE_SCHED && CONF_WITH_USER_ASPACE && CONF_WITH_PCLONE && CONF_WITH_PRIVATE_CLONE_TEST
    depends on CONF_WITH_MMAP && CONF_WITH_PTHJOIN
    depends on !ARCH_ARM || MACHINE_VIRT_ARM
    depends on !CONF_WITH_NATIVE_PREEMPT
    default n
    help
      Private test-only preparation arms one retained user-return operation.
      A genuine eligible device IRQ can park it at the verified outer return,
      run another THREAD, then restore the owned architectural frame. No timer
      quantum, public opcode or production preemption policy is enabled.

endmenu
```
