## bdos/Kconfig
```kconfig
#
# bdos/Kconfig - GEMDOS options
#
# Copyright (C) 2025-2026 The pTOS development team.
#
# This file is distributed under the GPL, version 2 or at your
# option any later version.  See doc/license.txt for details.
#

menu "GEMDOS (BDOS)"

config CONF_WITH_IMAGE_POLICY_TEST
    bool "Immutable executable-policy preparation (test only)"
    depends on CONF_WITH_MULTITHREADING
    default n
    help
      Verify immutable executable metadata capture and activation through
      the trusted shared-VM clone. The native companion also uses the
      clone lifetime diagnostics. This has no public executable ABI.

config CONF_WITH_EXEC_REPLACE
    bool "Pexec(200): replace the program in the same process"
    depends on CONF_WITH_MULTITHREADING
    depends on CONF_WITH_ELF_LOADER || (ARCH_M68K_CLASSIC && CONF_WITH_PRG_LOADER)
    default y
    help
      Replace the calling program with a new executable while keeping its
      PROCESS, PID, THREAD, files, current directories, parent and children.
      The replacement's format determines its startup ABI. On classic m68k
      this supports PRG and ELF independently of the caller's format.
      Successful replacement frees the old image after a safe handoff.
      Failure returns an error to the original program.

config CONF_WITH_EXEC_REPLACEMENT_TEST
    bool "Private executable image staging (test only)"
    depends on CONF_WITH_EXEC_REPLACE
    default n
    help
      Build the Pexec(200) regression probes: private image staging and
      reversible admission, injected failures at every receipt, image-bundle
      and commit stage, an identity/root/generation query and a committed-exec
      generation waiter, plus the EXEC200 native test programs.

config CONF_WITH_EXEC_HANDOFF_TEST
    bool "Same-image NORETURN execution transport (test only)"
    depends on CONF_WITH_EXEC_REPLACEMENT_TEST
    default n
    help
      Exercise the permanent scheduler root's same-PROCESS/TID handoff to
      fresh user startup and kernel stacks. Keeps the same image and root;
      this is not executable replacement or a committed-exec producer.
      No shipped preset enables this experiment.

config CONF_WITH_PROCESS_FILES
    def_bool CONF_WITH_MULTITHREADING
    help
      Build process_files.o and the PROCESS descriptor, DTA and search
      state used by managed processes. Legacy callers keep their own handles.

config CONF_WITH_PROCESS_FILES_TEST
    bool "TEST ONLY: PROCESS file snapshot counters and fault injection"
    depends on CONF_WITH_PROCESS_FILES
    default n

config CONF_WITH_FPOLL_TIME64
    def_bool CONF_WITH_PROCESS_FILES && CONF_WITH_USER_COPY
    depends on !TARGET_AMIGA_ROM || CONF_AMIGA_ROM_512K
    help
      Provide GEMDOS descriptor polling and monotonic waits. On Amiga the
      poll engine needs the 512 KB ROM format, also used by the full
      native 68030 scheduler test profile.

config CONF_WITH_PRIVATE_CLONE
    def_bool CONF_WITH_FORK || (CONF_WITH_PRIVATE_CLONE_TEST && !CONF_M68K_ROM_WINDOW && !CONF_WITH_MFASTCALL)
    help
      Build the COW clone implementation when public fork or the private-VM
      regression selector can use this backend. ROM-window address spaces
      do not implement cloning.

config CONF_WITH_USER_PAGE_FAULTS
    def_bool CONF_WITH_DEMAND_PAGING || CONF_WITH_PRIVATE_CLONE
    help
      Install the user page-fault recovery path for demand backing or COW.
      Eager address spaces still need recovery for writes to COW pages.

config CONF_WITH_PRIVATE_CLONE_TEST
    bool "Native private-VM clone/COW tests (test transport only)"
    depends on CONF_WITH_MULTITHREADING
    default n
    help
      Enable private Pclone test selectors for clone and mapping lifetimes.
      Private-VM cases use COW where the MMU backend provides it.

config CONF_WITH_PRIVATE_SNAPSHOT_TEST
    bool "Native captured private-snapshot ownership tests (test only)"
    depends on CONF_WITH_PRIVATE_CLONE_TEST && CONF_WITH_PRIVATE_CLONE && CONF_WITH_DEMAND_PAGING
    default n
    help
      Verify a surviving shared descendant privately clones an absent captured
      ancestor stack, after the original stack owner has exited. This uses the
      existing trusted clone and mapping lifetime machinery, not public fork.

config CONF_PCLONE_STACK_ALIGNMENT
    int
    default 16 if ARCH_X86_64
    default 8 if ARCH_ARM
    default 2

config CONF_PCLONE_MIN_STACK
    int
    default 256 if ARCH_X86_64
    default 16

config CONF_PCLONE_ENTRY_ALIGNMENT
    int
    default 1 if ARCH_X86_64
    default 4 if ARCH_ARM
    default 2

config CONF_WITH_MULTITHREADING
    bool "Native process scheduling and multithreading"
    depends on CONF_WITH_USER_ASPACE && (!ARCH_ARM || CPU_ARMV7)
    default y
    help
      Native PROCESS and THREAD scheduling, asynchronous launch, yield,
      child and thread waits, runnable Pclone and Ptermgrp. Managed
      processes own their descriptors, current directories and DTA state.
      Available with or without a desktop.

config CONF_WITH_PREEMPTION
    bool "Timer preemption of supported native USER continuations"
    depends on CONF_WITH_MULTITHREADING
    depends on ARCH_X86_64 || (ARCH_ARM && CPU_ARMV7) || (ARCH_M68K_CLASSIC && !CONF_WITH_MFASTCALL && (MACHINE_VIRT_M68K || CONF_M68K_ROM_WINDOW_040))
    default y
    help
      Phase C: a 20 ms quantum on the existing 200 Hz system timer, using
      the ordinary scheduler and retained hardware IRQ return transaction.
      Kernel, callback and nested launcher interruptions only defer work.
      Initial profiles are x32 without TLS/XSAVE, ARMv7 A32/D32, and 68040
      format-0 with supported idle FPU and the stack ABI. Runtime eligibility
      still refuses unsupported controls, frames and CPU/FPU combinations;
      selecting a 040 ROM does not qualify an actual 030 or 060 CPU.
      Disable this option to retain cooperative scheduling.

config CONF_WITH_IRQ_RESTART
    def_bool CONF_WITH_IRQ_RESTART_TEST || CONF_WITH_PREEMPTION


config CONF_WITH_LEGACY_PEXEC
    def_bool ARCH_M68K
    help
      The historical staged-execution Pexec modes 3 (load only, PRG targets
      only), 5/7 (create a basepage) and 4/6/104/106 (start one with the
      classic PRG entry). They are 68k TOS/FreeMiNT compatibility: ARM and
      x32 refuse them with EINVFN and do not carry their machinery
      (doc/pexec-legacy-modes.txt).

config CONF_WITH_STAGED_PEXEC
    def_bool CONF_WITH_LEGACY_PEXEC || (!CONF_WITH_USER_ASPACE && !ARCH_ARM)
    help
      Public staged GEMDOS Pexec modes. ARM keeps staged ROM and accessory
      launches as internal calls only.

config CONF_WITH_LEGACY_ELF_ARGS
    def_bool CONF_WITH_ELF_SHARED || (CONF_WITH_LEGACY_PEXEC && CONF_WITH_USER_ASPACE && CONF_WITH_ELF_LOADER)
    help
      Decode a GEMDOS tail and flat environment for the standard ELF stack.
      Static m68k ELF uses this even without the runtime linker.

config CONF_WITH_ARM_SHARED_EXEC
    def_bool ARCH_ARM && !CONF_WITH_USER_ASPACE && CONF_WITH_ELF_LOADER
    help
      Use the public Pexecve ABI and standard ELF startup with ARM's
      synchronous shared-address-space launcher.

config CONF_WITH_M68K_SHARED_EXEC
    bool "Pexecve in the shared m68k address space"
    depends on ARCH_M68K_CLASSIC && !CONF_WITH_USER_ASPACE
    depends on CONF_WITH_PRG_LOADER || CONF_WITH_ELF_LOADER
    default y
    help
      Provide synchronous Pexecve(0) for the configured executable
      formats. ELF receives the vector startup stack and PRG receives a
      classic GEMDOS basepage with synthesized tail and environment.
      Disable this to save space in a custom ROM.

config CONF_WITH_SHARED_EXEC
    def_bool CONF_WITH_ARM_SHARED_EXEC || CONF_WITH_M68K_SHARED_EXEC

config CONF_WITH_PEXECVE
    def_bool CONF_WITH_SHARED_EXEC || (CONF_WITH_USER_ASPACE && (CONF_WITH_MULTITHREADING || CONF_WITH_NATIVE_ABI))

config CONF_WITH_PRG_VECTORS
    def_bool CONF_WITH_PRG_LOADER && (CONF_WITH_MULTITHREADING || CONF_WITH_M68K_SHARED_EXEC)

config CONF_WITH_SHARED_VM_PEXEC
    def_bool CONF_WITH_MULTITHREADING && CONF_WITH_USER_ASPACE && CONF_WITH_LEGACY_PEXEC && CONF_WITH_PRG_LOADER
    help
      m68k MMU kernels: Pexec modes 4 and 104 start a staged PRG as a
      distinct PROCESS sharing the caller's address space, entered with the
      classic PRG convention (doc/pexec-legacy-modes.txt). Without an MMU,
      mode 4 runs the basepage in place as on TOS. It needs the PRG loader:
      the classic TPA of mode 5/7 and the preparation's TPA permissions are
      the PRG loader's; without it, 4/104 from a process are EINVFN.

config CONF_WITH_PROCESS_EXEC
    bool
    depends on CONF_WITH_USER_ASPACE && CONF_WITH_MULTITHREADING && CONF_WITH_SSYSTEM
    default y if !CONF_WITH_PROCESS_EXEC_TEST
    help
      PROCESS-owned launch and observation with S_PROCEXEC discovery. This
      service is available to native PROCESSes without a GUI registration.

config CONF_WITH_PROCESS_EXEC_DISPATCH
    bool
    default y if CONF_WITH_PROCESS_EXEC || CONF_WITH_PROCESS_EXEC_TEST

config CONF_WITH_PROCESS_EXEC_TEST
    bool "TEST ONLY: suppress PROCESS transport discovery"
    depends on CONF_WITH_USER_ASPACE && CONF_WITH_MULTITHREADING && CONF_WITH_SSYSTEM
    default n
    help
      Keep the PROCESS transport callable while S_INQUIRE reports EINVFN.
      This exercises the dispatch and discovery boundary in validation builds.


config CONF_WITH_FORK_RETURN_TEST
    bool "Native saved syscall-return probe (test only)"
    depends on CONF_WITH_MULTITHREADING
    depends on !ARCH_M68K || !CONF_WITH_MFASTCALL
    depends on !ARCH_ARM || CPU_ARMV7
    default n
    help
      Enable a private Pclone test selector for shared-VM saved-return startup.
      The sole-thread parent is blocked while the child uses its user stack.
      With PRIVATE_CLONE_TEST, the private selector also tests independent
      saved-return COW execution; its parent returns without waiting. Neither
      selector supplies full PROCESS resource inheritance or a public fork ABI.
      ARM admission is limited to the reviewed ARMv7 backend; the RPi1's
      VFP-only target is not supported by the D32 register probe.
      This test selector is not Pfork or Pvfork (CONF_WITH_FORK).

config CONF_WITH_FORK_CORE
    bool
    depends on CONF_WITH_MULTITHREADING && CONF_WITH_PRIVATE_CLONE
    default y if CONF_WITH_FORK_RETURN_TEST && CONF_WITH_PRIVATE_CLONE_TEST
    default y if CONF_WITH_FORK
    help
      Internal common PRIVATE_VM/COW fork and exact-child parent dependency,
      used by public Pfork/Pvfork and by the native test transport.

config CONF_WITH_SAVED_RETURN
    bool
    depends on CONF_WITH_MULTITHREADING
    depends on !ARCH_M68K || !CONF_WITH_MFASTCALL
    depends on !ARCH_ARM || CPU_ARMV7
    default y if CONF_WITH_FORK_RETURN_TEST || CONF_WITH_FORK || CONF_WITH_PREEMPTION
    default y if ARCH_M68K && CONF_WITH_IRQ_RESTART_TEST
    help
      Internal: capture a system call's user return image so a new THREAD
      resumes after the same trap (Pfork/Pvfork and the test probe).

config CONF_WITH_FORK
    bool "Public Pfork and Pvfork"
    depends on CONF_WITH_EXEC_REPLACE
    depends on ARCH_X86_64 || (ARCH_ARM && CPU_ARMV7) || (ARCH_M68K_CLASSIC && !CONF_M68K_ROM_WINDOW && !CONF_WITH_MFASTCALL)
    default y
    help
      MiNT Pfork() and Pvfork(): the sole THREAD of a PROCESS forks an
      independent PROCESS with a private copy-on-write address space that
      resumes after the same trap, returning 0 there and the child's PID to
      the parent. The child inherits every descriptor, the current
      directories and DTA/search state (CONF_WITH_PROCESS_FILES), the
      environment and limits. Pfork's parent continues at once; Pvfork's
      parent waits until the child's final completion or its committed
      Pexec(200). Unlike FreeMiNT's Pvfork, the child's private writes never
      reach the parent's memory. A multi-THREAD or shared-root caller gets
      EACCDN. Only an
      anchor execution may fork: one started with Pexec(100), public
      Pexec(104) on m68k only, a clone, or Pexec(0) from a managed THREAD,
      whose child is an anchor its caller waits for, as in FreeMiNT (#1015).
      A program the kernel or a user callback runs nested in its launcher's
      Pexec(0) owns no dependents and gets EINVFN, as for Pclone.
      Supported where the return image is admitted: x86-64 with default
      segments and no FS/GS base, ARMv7 A32 with an idle VFP state and a
      68040 format-0 trap frame with an idle FPU; on
      any other CPU or state both calls return EINVFN.


config CONF_LOGSEC_SIZE
	int "Maximum logical sector size, in bytes"
	default 512
	range 512 16384
	help
	  Maximum size of the logical sectors GEMDOS can handle.  If a
	  larger value is found on a mounted drive during startup, that
	  value is used instead.  The value must be a power of two between
	  512 and 16384 inclusive.

	  This is only significant for Atari style FAT filesystems; DOS
	  style FAT filesystems always use 512 byte logical sectors.

config CONF_PREFER_STRAM_DISK_BUFFERS
	bool "Allocate the disk buffers in ST-RAM"
	default y if CONF_ATARI_HARDWARE
	default n
	help
	  Say y when disk buffers are more efficient in ST-RAM, which is the
	  case whenever floppy or ACSI DMA transfers are used.

config CONF_WITH_ELF_LOADER
	bool "Load ELF executables"
	default y if ARCH_ARM || ARCH_X86_64
	default n
	help
	  Add a second, ELF based executable loader alongside the classic
	  Atari GEMDOS PRG format.  Pexec() picks the loader by inspecting the
	  file's magic number, so both formats can coexist.

	  The program must be a statically linked ELF for this machine, in one
	  of two forms:

	    * a fixed base ET_EXEC linked with "ld --emit-relocs" (ld -q),
	      which keeps its relocation entries in the binary, or
	    * a position independent ET_DYN (PIE, "ld -pie
	      --no-dynamic-linker").

	  The loader places the PT_LOAD segments in the TPA and applies the
	  retained relocation entries, exactly like the PRG loader applies its
	  own relocation table.  It reads the relocations from the section
	  headers, so the binary must keep them (do not strip it).

	  On x86-64 (#334) this is the ELFCLASS32/EM_X86_64 x32 psABI, not
	  IA-32/EM_386 compat-mode code -- see tests/x32_hello/x32_hello.c.

	  This is enabled by default on ARM and x86-64, neither of which can
	  produce the m68k specific PRG format at all, and is available on
	  m68k as an alternative to PRG.

config CONF_WITH_PTOS_ABI_IMPORTS
	bool "Native pTOS ABI imports for ELF executables"
	depends on CONF_WITH_ELF_LOADER
	default n
	help
	  Let a native ELF executable import pTOS system functions as ordinary
	  typed C function calls, resolved by Pexec() against a kernel-side
	  export table instead of requiring the caller to build a TRAP #1
	  parameter block by hand. See doc/elfload.txt's "Native pTOS ABI
	  imports" section for the .ptos.imports/.ptos.bind ELF metadata format
	  and bdos/elfld.c's resolution mechanism this enables.

	  CONF_WITH_X32_VDI selects this and registers vdi:vdi, ABI 1.0, for
	  x32 programs. That entry executes in a read-only user client image
	  mapped privately into each process, with narrow syscalls for hardware
	  access. No LP64 kernel code or data address is bound into x32 code.
	  AES applications use the standard userspace libaes shared library.
	  Other native namespaces, including retired aes: and gemdos imports,
	  are refused.

config CONF_WITH_USER_CALLBACKS
	bool "Typed callbacks on x32 user stacks"
	depends on ARCH_X86_64 && CONF_WITH_USER_ASPACE && CONF_WITH_KHEAP
	default y if CONF_WITH_X32_VDI
	help
	  Process-owned callback registrations, authenticated return/chaining
	  stubs, alternate stacks and bounded nested ring-3 delivery. The
	  legacy m68k and ARM callback conventions are unchanged.

config CONF_WITH_KPROC
	bool "Kernel-private process records" if !ARCH_X86_64
	default y if ARCH_X86_64
	default n
	help
	  Keep a kernel-owned record per process (struct kproc, bdos/kproc.c)
	  beside the public GEMDOS basepage, so state the kernel must be able
	  to trust never has to live in memory the process can write: the
	  launching process (used by Pterm() instead of the basepage's p_parent),
	  whether the process was launched, its DTA pointer, and its standard
	  handle map and current directories, which are then no longer read
	  from or written to the basepage's p_uft and p_curdir fields (as in
	  FreeMiNT).

	  Mandatory on x86-64, where ring-3 processes can write their whole
	  basepage and the record is load-bearing.  On other architectures it
	  is optional and off by default: nothing there protects the kernel
	  from a program anyway, and programs that look at p_uft/p_curdir of
	  their basepage see zeros when it is on.  Turn it on to exercise the
	  same code the x86-64 port runs.

config CONF_WITH_PROCMEM
	bool
	select CONF_WITH_KPROC
	help
	  The memory blocks of a process (its basepage with the TPA, and its
	  environment) come from a window of kernel memory managed by
	  include/procmem.h instead of from the GEMDOS memory descriptor lists:
	  every block has an owner, a generation and a pin count, so that a
	  stale or foreign address is recognised, and the blocks are reachable
	  by a 32-bit address (on x86-64, while the kernel itself is 64-bit).
	  Not user-selectable: CONF_WITH_USER_ASPACE, which needs it, sets it.

config CONF_WITH_USER_ASPACE
	bool
	default y if ARCH_HAS_USER_ASPACE
	select CONF_WITH_PROCMEM
	select CONF_WITH_KHEAP
	select CONF_WITH_KPROC
	select CONF_WITH_USER_COPY
	help
	  Processes run in user mode in per-process address spaces (ring 3
	  on x86-64; doc/x86_64-address-space.txt, doc/mmu-address-space.txt):
	  the record also carries the process's page tables, kernel stack,
	  memory-block identities and loans, and its read-only copies of its
	  ancestors' basepages, and the DTA pointer in it is the only one
	  trusted.  Not user-selectable: it is on where the architecture has
	  an address-space backend (ARCH_HAS_USER_ASPACE, include/procmem.h),
	  and requires CONF_WITH_KPROC.

config CONF_WITH_DEMAND_PAGING
	bool "Back user memory when it is first touched"
	depends on CONF_WITH_USER_ASPACE && ARCH_HAS_DEMAND_PAGING
	default y
	help
	  A process's stack and Malloc() blocks are address space until it
	  touches them: the page fault handler gives each page its zeroed
	  physical page then, so untouched memory costs nothing and the
	  default stack can be 16 MiB.  Without it every page is mapped when
	  the memory is handed out, and the default stack is 256 KiB.
	  Offered where the address-space backend can do it
	  (ARCH_HAS_DEMAND_PAGING); turn it off to run the eager path a
	  backend without it uses.

config CONF_WITH_FAT_FILE_LIFETIMES
	bool "Extended native FAT file lifetimes"
	default n if TARGET_192
	default y
	help
	  Keep deleted files alive until their last open handle or backing
	  reference is released. Retain and retry interrupted name removal
	  and FAT-chain reclamation without reallocating pending clusters.
	  Disable for small ROMs to use traditional GEMDOS deletion: files
	  open by another process cannot be deleted, and this process's open
	  files are closed before their clusters are freed. File mappings
	  require the extended implementation.

config CONF_WITH_FILE_PINS
	bool
	select CONF_WITH_FAT_FILE_LIFETIMES
	help
	  Retain native file backing independently of GEMDOS handles. Selected
	  by file mappings and by their lifetime self-tests; ordinary unlink
	  lifetime support does not require this internal kernel entry point.

config CONF_WITH_MMAP
	bool "Private anonymous and file-backed process mappings"
	depends on CONF_WITH_USER_ASPACE && CONF_WITH_DEMAND_PAGING
	select CONF_WITH_FILE_PINS
	default n
	help
	  Provide Mmap, Munmap and Mprot for private anonymous and native FAT
	  file pages in allocatable per-process address ranges. File pages are shared
	  read-only until a private write fault; anonymous pages stay lazy zero.
	  Enforce W^X, lifetime and memory limits. MAP_SHARED and replacing
	  MAP_FIXED are not supported.  Needs isolated MMU address spaces
	  with demand paging: x32, and the 32-bit ARM and m68k backends.

config CONF_WITH_ELF_SHARED
	bool "Experimental userspace ELF shared-library linker core"
	depends on CONF_WITH_ELF_LOADER && CONF_WITH_USER_ASPACE
	depends on ARCH_X86_64 || ARCH_ARM || ARCH_M68K
	depends on CONF_WITH_DEMAND_PAGING
	select CONF_WITH_MMAP
	default n
	help
	  Build the freestanding userspace linker core for standard ELF shared
	  objects.  Requires isolated, MMU-backed process address spaces: x32
	  and ARM (hard-float EABI, ARM state) have the backends, and the 68040
	  address-space configurations (built with a PIC-capable m68k compiler).

	  Includes a freestanding ld.so and a separate dynamic CRT/client subset.
	  Private mapping/protection services use Mmap, Munmap and Mprot; interpreter
	  handoff and a private argc/argv/envp/auxv stack are implemented and tested.
	  Eager x32 relocation and dependency discovery are available in the core.
	  DSO pages use retained file-backed private mappings and write-fault COW.
	  A complete shared libcmini and advanced ELF features remain separate.
	  The core is built separately from the kernel, in obj/ldso/.

config CONF_WITH_ELF_VECTOR_ENTRY_TEST
	bool "Native static ELF vector entry probe (test only)"
	depends on CONF_WITH_ELF_SHARED && CONF_WITH_MULTITHREADING
	depends on CONF_WITH_X86_64_MEMTEST || CONF_WITH_EXIT_HANDOFF_TEST
	help
	  Load and run STKVEC.ELF from the native regression disk with trusted
	  argument vectors. The probe uses the ordinary executable loader and
	  enters user mode through the standard ELF initial stack.

config CONF_WITH_KHEAP
	bool
	help
	  A growable heap for kernel-only objects (include/kheap.h):
	  kernel-private process records (struct kproc) and address-space
	  metadata come from it instead of the fixed GEMDOS memory descriptor
	  pool, so their number is bounded by memory, not by that pool.  The
	  machine provides it.  Not user-selectable: CONF_WITH_USER_ASPACE,
	  which needs it, sets it.

config CONF_WITH_KCALL
	bool
	default y if ARCH_X86_64
	default y if CONF_WITH_USER_ASPACE
	help
	  Kernel code calls GEMDOS functions as plain C calls to their
	  implementations (bdos/kcall.c) instead of through a
	  trap, because the trap path belongs to the processes.  Only the
	  calls kernel code makes exist.  Not user-selectable: it follows
	  the architecture.

config CONF_WITH_SSYSTEM
	bool
	default y if ARCH_ARM || ARCH_X86_64
	default y if CONF_WITH_USER_ASPACE
	help
	  Ssystem() (GEMDOS 0x154, bdos/ssystem.c) is written in C and
	  dispatched from osif(); on the other architectures it is handled by
	  the assembly trap entry.  Not user-selectable: it follows the
	  architecture, and the options that need it (the desktop as a
	  program, CONF_EXTERNAL_DESK, which asks the kernel what it used to
	  read from its variables) select it on m68k.

config CONF_WITH_GEMDOS_SHUTDOWN
	bool "Shutdown() GEMDOS call"
	default n if TARGET_192 || TARGET_256 || TARGET_CART
	default y
	help
	  Add GEMDOS Shutdown() (0x151, as in MiNT and MagiC): close all files,
	  write out the disk buffers, then power off, restart or halt.  Where
	  the machine has no software power-off or reset (the Atari ST and
	  its relatives have no power-off at all) it ends in the "safe to turn
	  off your computer" message instead.  Off by default for the ROM
	  images that have no room left (192 KB, 256 KB, the cartridge).
	  The power off is what
	  CONF_WITH_SHUTDOWN (bios/Kconfig) provides where that is set.

config CONF_WITH_USER_COPY
	bool "Validate the pointers passed to GEMDOS calls" if !ARCH_X86_64 && CONF_WITH_KPROC
	default y if ARCH_X86_64
	default n
	help
	  Check the pointer arguments of every GEMDOS (trap 1) call against the
	  calling process before the call runs (bdos/uaccess.c): each pointer a
	  call really uses must lie in memory the process may read, or write for
	  an output, for its whole length, with no wrap-around, and strings must
	  end within a bound.  A bad pointer makes the call fail with EIMBA
	  (ERANGE for a bad length) instead of the kernel dereferencing it.
	  Arguments a call does not use are never looked at.

	  Mandatory on x86-64, where the kernel runs under the calling
	  process's page tables and would otherwise touch the system variables
	  or another block through a pointer it was handed.  Optional and off by
	  default elsewhere (on m68k the packed argument frame of the trap is
	  first unpacked into one value per argument, in bdos/bdosmain.c);
	  without per-process address spaces the checks only look for null
	  pointers and bad lengths.  Other call classes (BIOS,
	  XBIOS, VDI, AES) are guarded by the same option as they are converted.

config CONF_WITH_PRG_LOADER
	bool "Load classic Atari GEMDOS PRG executables"
	depends on ARCH_M68K
	default y
	help
	  Recognize and load the classic Atari GEMDOS PRG executable format
	  (magic 0x601a) in Pexec().  A PRG's TEXT segment is raw m68k machine
	  code with an m68k specific relocation table; loading one just places
	  those bytes in the TPA and jumps in, with no check that the CPU
	  running Pexec() can execute them. That is only meaningful where the
	  file can only ever contain m68k code, so this is restricted to m68k
	  targets - a non-m68k machine must not go looking for, and jumping
	  into, code in a foreign instruction set. Non-m68k targets rely on
	  CONF_WITH_ELF_LOADER instead.

config CONF_WITH_BINFMT
	bool "Boot-configured executable interpreters and shebang scripts"
	default n if TARGET_192 || TARGET_256 || TARGET_CART
	default n if TARGET_AMIGA_ROM && !CONF_AMIGA_ROM_512K
	default y
	help
	  Read PTOS.INI once from the boot drive before starting applications.
	  Register general magic/mask executable handlers and support #! scripts
	  through the same bounded interpreter path. Native formats take
	  precedence. No proc filesystem or runtime registration API is needed.
	  See doc/binfmt.txt for the INI syntax and implementation limits.

endmenu
```
