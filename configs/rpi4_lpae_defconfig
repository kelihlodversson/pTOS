## vdi/Kconfig
```kconfig
#
# vdi/Kconfig - VDI options
#
# Copyright (C) 2025-2026 The pTOS development team.
#
# This file is distributed under the GPL, version 2 or at your
# option any later version.  See doc/license.txt for details.
#

menu "VDI"

config CONF_WITH_VDI_BACKEND_PLANAR
	bool "Planar (indexed bitplane) VDI backend"
	default y if !MACHINE_RPI
	default n
	help
	  Build the planar (interleaved-bitplane) VDI backend -- the classic
	  Atari screen layout, and the only renderer needed for any indexed
	  planar screen (all Atari-family machines, virt-arm, virt-m68k).

	  Disabling it while the truecolor backend is enabled removes the
	  runtime dispatcher (see vdi/build.mk), which is what a machine whose
	  descriptor can only report packed truecolor -- like the Raspberry
	  Pi -- wants.  At least one renderer must stay enabled.

config CONF_WITH_VDI_BACKEND_TRUECOLOR
	bool "Packed truecolor VDI backend" if !MACHINE_RPI
	default y if MACHINE_RPI || MACHINE_VIRT_ARM || MACHINE_VIRT_M68K || MACHINE_PC_X86_64
	default n
	help
	  Build the packed-truecolor VDI backend (vdi_backend_truecolor.o),
	  for packed 16bpp RGB565 framebuffers.  Raspberry Pi is the first
	  machine that uses it -- see issue #35.

	  Raspberry Pi's screen descriptor unconditionally reports a
	  truecolor mode, so this backend is mandatory there: the prompt is
	  hidden (and the option forced to y) whenever MACHINE_RPI is set,
	  since turning it off would leave the RPi screen with no matching
	  renderer.

config CONF_WITH_VDI_BACKEND_TRUECOLOR32
	bool "Packed 32bpp XRGB8888 truecolor VDI backend"
	depends on CONF_WITH_VDI_BACKEND_TRUECOLOR && CONF_WITH_VDI_BACKEND_DISPATCH
	default y if MACHINE_VIRT_ARM || MACHINE_VIRT_M68K || MACHINE_PC_X86_64
	help
	  Build the XRGB8888 (32bpp) variant of the packed-truecolor VDI
	  backend (vdi_backend_truecolor32.o), sharing its drawing code with
	  the 16bpp RGB565 backend via the PIXEL/PIXEL_SIZE template
	  (vdi_backend_truecolor_tmpl.c).  Only selectable with the runtime
	  dispatcher enabled, since a single-renderer 32bpp build is not a
	  supported configuration.

	  The active pixel format comes from the screen mode descriptor
	  (SCREEN_PIXEL_XRGB8888), never from per-machine code.  Raspberry Pi
	  stays RGB565; this exists for machines like QEMU's virt-arm, and the
	  EFI GOP framebuffer on pc-x86_64 (#332), whose framebuffer is
	  32 bpp -- see issue #91.

config CONF_WITH_VDI_BACKEND_DISPATCH
	bool
	default y if CONF_WITH_VDI_BACKEND_PLANAR && CONF_WITH_VDI_BACKEND_TRUECOLOR
	help
	  Runtime dispatch between more than one VDI renderer.  Derived: it
	  is on exactly when two or more renderers are enabled, so a single
	  renderer build carries no dispatch machinery at all -- the callers
	  call that one renderer's primitives directly.

config CONF_VDI_SPARSE_TABLE
	bool "Exercise the generic backend defaults"
	depends on CONF_WITH_VDI_BACKEND_DISPATCH
	default n
	help
	  For testing issue #138's generic dispatch-table defaults: make the
	  packed-truecolor backend leave its optional ops slots NULL so the
	  dispatcher's init function fills them with the generic default
	  implementations, which are then exercised against the real RGB565
	  framebuffer.  Only meaningful when both renderers are enabled
	  (otherwise there is no dispatcher).  Do not enable in production
	  images.

config CONF_WITH_LINEA
	bool "Line-A emulator"
	default n if MACHINE_RPI
	default y
	help
	  Install the obsolete line-A emulator.  It should be enabled for
	  backwards compatibility on 68k-class hardware.

config CONF_WITH_VDI_EXTENSIONS
	bool "VDI extension functions"
	default n if TARGET_192 || TARGET_CART
	default y

config CONF_WITH_GDOS
	bool "GDOS-aware text output"
	default y
	help
	  Generate code within vst_load_fonts() and vst_unload_fonts() to
	  recognise when GDOS is present and behave accordingly.

config CONF_WITH_VDI_16BIT
	bool "16-bit truecolor VDI support"
	depends on CONF_WITH_VIDEL
	default y
	help
	  VDI support for the Falcon's Videl 16-bit (32768/65536 colour)
	  screen modes.

config CONF_WITH_VDI_TEXT_SPEEDUP
	bool "VDI text output speedup"
	default y
	help
	  Improve some VDI text output cases for legibility/performance.

config CONF_WITH_VDI_TEXT_EFFECTS_SPEEDUP
	bool "VDI text effects speedup"
	default n if TARGET_192
	default y
	help
	  Draw bold, skewed, and bold and skewed text faster on big-endian
	  CPUs: bold strings go to the blitter a string at a time, skewed
	  glyphs are set up once for all planes, and bold and skewed glyphs
	  are thickened only once.  It takes some 2.5 KB of ROM, which the
	  192 KB images do not have to spare.

config CONF_WITH_VDI_SCALABLE_FONTS
	bool "Scalable fonts (FreeType)"
	select CONF_WITH_GDOS
	default y if TARGET_RPI_KERNEL || TARGET_VIRT_ARM_KERNEL
	default y if TARGET_VIRT_M68K_KERNEL || TARGET_PC_X86_64_EFI
	default n
	help
	  Link the FreeType library (the lib/freetype submodule) into the
	  VDI, to give it TrueType and OpenType fonts at any size (#573).
	  FreeType is used under its GPL option ("version 2, any later
	  version can be used also"), the same terms as pTOS's own.

	  It adds a few hundred KB, so it is on by default only for the
	  images that have no fixed size (the Raspberry Pi, virt and x86-64
	  kernels) and off for the ROM, cartridge, floppy, Amiga and
	  S-record images, and for the RAM TOS, which has to fit in the RAM
	  of small machines.

	  Needs the submodule: git submodule update --init lib/freetype

config CONF_VDI_FONT_MEMORY
	int "Memory for the scalable fonts, in KB"
	depends on CONF_WITH_VDI_SCALABLE_FONTS && !CONF_WITH_KHEAP
	range 256 65536
	default 4096
	help
	  The memory FreeType uses (font files, which are loaded whole, the
	  faces, sizes and glyphs it works with, and its own stack) is kept
	  out of GEMDOS: it is set aside while the system starts, and is
	  the kernel's, not that of whichever program the VDI happens to be
	  working for.  A TrueType font file takes from 20 KB to about 1 MB.
	  The x86-64 kernel uses its growable kernel heap instead.

config CONF_VDI_FONT_CACHE
	int "Memory for rendered sizes of the scalable fonts, in KB"
	depends on CONF_WITH_VDI_SCALABLE_FONTS
	range 64 16384
	default 1024
	help
	  Each size of a scalable font that is selected is rendered whole,
	  as a bitmap font of that size, and kept for the next time.  This
	  bounds the memory those sizes take, out of the font memory: the
	  sizes used longest ago that no workstation has selected are
	  dropped to make room.  A size that would not fit by itself is
	  made smaller until it does.

config CONF_VDI_FONT_DIR
	string "Directory of the scalable fonts"
	depends on CONF_WITH_VDI_SCALABLE_FONTS
	default "\\GEMSYS\\FONTS"
	help
	  Where the built-in GDOS looks for TrueType (*.TTF), OpenType
	  (*.OTF) and TrueType collection (*.TTC) fonts, once the AUTO
	  folder has run.  Without a drive letter, it is on the boot drive.
	  The fonts found are what vst_load_fonts() adds to a workstation,
	  as SpeedoGDOS does.  A missing or empty directory just leaves
	  the bitmap fonts.  The release images put DejaVu fonts here
	  (tools/fetch-fonts.sh).

config CONF_VDI_SYSTEM_FONT
	string "Monospaced scalable font to replace the system font (file name)"
	depends on CONF_WITH_VDI_SCALABLE_FONTS
	default ""
	help
	  The 8-bit file name, in the font directory, of a monospaced
	  TrueType or OpenType font that the built-in GDOS makes the system
	  font of (font id 1): of the VT52 console, the AES, the desktop,
	  and of every program that picks no other font.  It is rendered at
	  the cells of the 8x8 and 8x16 ROM fonts, which keep their sizes
	  and metrics; a character it lacks keeps the glyph of the ROM font.
	  The 6x6 font stays as it is.  Empty: the ROM fonts.

	  A file \GEMSYS\PTOS.INF on the boot drive with a line
	  "SYSTEMFONT=NAME.TTF" takes the place of this, without a rebuild.
	  Only with the Atari ST character set, and only where the built-in
	  GDOS starts (none loaded from disk).  A font that is missing, is
	  not monospaced, or cannot be read leaves the ROM fonts.

config CONF_WITH_VDI_VERTLINE
	bool "VDI vertical line drawing speedup"
	default n if TARGET_192
	default y
	help
	  Improve VDI vertical line drawing performance.

config CONF_RASPI_MOUSE_CURSOR
	bool "Use the Raspberry Pi hardware mouse cursor"
	depends on MACHINE_RPI
	default y if TARGET_RPI1 || TARGET_RPI2 || TARGET_RPI3
	default n
	help
	  Draw the mouse pointer using the hardware cursor of the VideoCore
	  GPU instead of drawing it into the framebuffer.

	  Enabled by default on real Pi 1-3 hardware, where it works. RPi4's
	  mailbox/GPU differences haven't been verified yet, so it defaults
	  off there (see issue #131). QEMU does not emulate the cursor
	  mailbox property tags; when they fail at runtime, the software
	  cursor is used instead regardless of this setting, so it is safe
	  to leave enabled for QEMU-targeted configs too.

endmenu
```
