## desk/Kconfig
```kconfig
#
# desk/Kconfig - EmuDesk options
#
# Copyright (C) 2025-2026 The pTOS development team.
#
# This file is distributed under the GPL, version 2 or at your
# option any later version.  See doc/license.txt for details.
#

menu "EmuDesk desktop"
	depends on CONF_WITH_AES

config CONF_WITH_WINDOW_ICONS
	bool "Icons for files and folders"
	default n if TARGET_192
	default y

config CONF_WITH_ALT_DESKTOP_GRAPHICS
	bool "Alternate desktop graphic elements"
	depends on CONF_WITH_EXTENDED_OBJECTS
	default n if TARGET_192 || TARGET_256 || TARGET_512
	default y
	help
	  Replace Atari-style desktop graphic elements with alternate
	  versions, e.g. left-aligned and underlined dialog titles instead
	  of the centered, unadorned Atari TOS style.

config CONF_WITH_DESKTOP_SHORTCUTS
	bool "Desktop shortcuts"
	default n if TARGET_192
	default y
	help
	  Allow files and folders to be installed on the desktop as
	  shortcuts.

config CONF_WITH_BACKGROUNDS
	bool "Configurable backgrounds"
	default n if TARGET_192
	default y
	help
	  Allow the background pattern and colour of the desktop and of the
	  windows to be configured.

config CONF_WITH_FILEMASK
	bool "Configurable file mask"
	default n if TARGET_192
	default y

config CONF_WITH_DESKTOP_CONFIG
	bool "Desktop configuration dialog"
	default n if TARGET_192
	default y

config CONF_WITH_READ_INF
	bool "Read .INF file"
	default n if TARGET_192
	default y
	help
	  Allow the user to merge an EMUDESK.INF file into the running
	  desktop's configuration via a "Read .INF file" menu item, without
	  restarting the desktop.

config CONF_WITH_VIEWER_SUPPORT
	bool "Default document viewer"
	default n if TARGET_192 || TARGET_256 || TARGET_512
	default y
	help
	  Allow an application to be marked as the default viewer (as on
	  Atari TOS 4), used to display document files that have no
	  installed application of their own.

config CONF_WITH_FORMAT
	bool "Floppy formatting"
	depends on CONF_ATARI_HARDWARE
	default n if TARGET_192 || MACHINE_ARANYM || MACHINE_FIREBEE
	default y

config CONF_WITH_SHOW_FILE
	bool "Show a file by double-clicking on it"
	default n if TARGET_192
	default y

config CONF_WITH_SEARCH
	bool "'Search' desktop menu item"
	default n if TARGET_192
	default y
	help
	  Prompt for a search string, then search for matching files and
	  folders, as on Atari TOS 2/3/4.

config CONF_WITH_SELECTALL
	bool "'Select all items' desktop menu item"
	default n if TARGET_192
	default y
	help
	  Select all items in the currently-topped window, as on Atari TOS
	  2/3/4.  Only items with an on-screen icon are marked; unlike Atari
	  TOS, items scrolled out of view are not.

config CONF_WITH_BOTTOMTOTOP
	bool "'Cycle windows' desktop menu item"
	default n if TARGET_192
	default y
	help
	  Top the bottom window, as on Atari TOS 2/3/4.

config CONF_WITH_SIZE_TO_FIT
	bool "'Size to fit' desktop menu item"
	default n if TARGET_192 || TARGET_256
	default y
	help
	  Control whether a window's width determines the number of columns
	  of files displayed (the only behaviour without this option), or
	  whether a window is a scrollable view onto the full width of the
	  desktop, as on Atari TOS 2/3/4.

config CONF_WITH_PRINTER_ICON
	bool "Printer icon"
	default n if TARGET_192
	default y
	help
	  Support a printer icon on the desktop: info/rename it like the
	  trash can, and install it (or remove it) via the "Install
	  application" dialog's printer button, as on Atari TOS 2/3/4.
	  Dragging a document onto it is not yet implemented.

config CONF_WITH_EASTER_EGG
	bool "EmuDesk easter egg"
	default n if TARGET_192
	default y

config CONF_EXTERNAL_DESK
	bool "Load EmuDesk from the boot drive instead of linking it in"
	depends on CONF_WITH_AES && !ARCH_X86_64
	depends on ((ARCH_ARM || BUILD_TOOLCHAIN_ELF) && CONF_WITH_ELF_LOADER) || (ARCH_M68K && !BUILD_TOOLCHAIN_ELF && CONF_WITH_PRG_LOADER)
	# the program talks to the VDI through trap #2, which a process in its
	# own address space cannot do: the kernels with per-process address
	# spaces refuse VDI and AES calls from user mode until they have a
	# validated GEM entry (doc/mmu-address-space.txt; on x86-64 that is
	# #548, for the MMU kernels it has no issue of its own yet)
	depends on !CONF_WITH_USER_ASPACE
	select CONF_WITH_SSYSTEM
	default y if TARGET_RPI_KERNEL || TARGET_VIRT_ARM_KERNEL || TARGET_VIRT_M68K_KERNEL
	help
	  Build the desktop as an ordinary program, emudesk.prg, and leave it
	  out of the kernel image.  The AES starts it with Pexec() from the
	  root directory of the boot drive (EMUDESK.PRG) when it runs the
	  desktop, and reads its settings from EMUDESK.INF there as before.
	  If the file is not there, the AES says so on the console and runs
	  EmuCON instead.

	  The program is made of the objects of desk/, the helpers of util/
	  and a small runtime (desk/deskrt.c) that gets what the kernel's own
	  desktop read from its variables -- the screen and character cell
	  sizes, the boot flags, whether the resolution can change -- through
	  the AES, the VDI and Ssystem(), which this option therefore turns on
	  on m68k.  It has to be on the boot drive: "make test-dir", "make
	  test-hd" and the Raspberry Pi archives put it there.

	  Needs the loader of the program's format: ELF on ARM and with the
	  bare m68k-elf toolchain (CONF_WITH_ELF_LOADER), PRG with the other
	  m68k toolchains (ColdFire builds and links, but has not been run).
	  Not offered for x86-64 (#651), nor with the MMU kernels, whose
	  processes cannot call the VDI and the AES yet (see above).

	  On by default for the images that are loaded into RAM from a disk
	  (Raspberry Pi, virt-arm, virt-m68k).

config CONF_WITH_VDI_CICON_TEST
	bool "Embedded colour-icon rendering test"
	depends on CONF_WITH_AES && CONF_WITH_COLOUR_ICONS && !CONF_WITH_LEGACY_RSC_LOAD
	# it uses the AES resource loader and an embedded resource of the kernel
	depends on !CONF_EXTERNAL_DESK
	default n
	help
	  Test hook for issue #107: embeds a hand-built 'new format' RSC
	  with a single G_CICON and draws it over the desktop background at
	  boot, exercising gr_gicon() -> gr_colourblit() on both the packed
	  truecolor (RPi) and the planar (Atari) paths.  For verification
	  only -- do not enable in production images.

endmenu
```

## fs/Kconfig
```kconfig
#
# fs/Kconfig - pluggable filesystem layer options
#
# This file is distributed under the GPL, version 2 or at your
# option any later version.  See doc/license.txt for details.
#

menu "Pluggable filesystems"

config CONF_WITH_PLUGGABLE_FS
	bool "Pluggable filesystem driver support"
	depends on !ARCH_X86_64
	default n
	help
	  Routes GEMDOS filesystem calls (Fopen, Fread, Dsetpath, Fsfirst,
	  ...) through a pluggable interface so a driver can expose a whole
	  filesystem as a GEMDOS drive.  The built-in FAT filesystem keeps
	  working either way: when off, the GEMDOS shims call fatfs_pfs.c's
	  fat_*_path() entry points directly; when on, they call the pfs_do_*()
	  helpers here, which dispatch through a per-drive vtable (with the
	  FAT implementation available as fat_pfs_ops).  Say n unless a driver
	  needs this.

	  Not offered on x86-64: fatfs_pfs.c's PFSCOOKIE-based directory/file
	  cookies pack a DND* into a plain 32-bit LONG when this is off,
	  spending the cookie's otherwise-unused "aux" field on the pointer's
	  high 32 bits to make that exact on every arch. This build's cookies
	  can't do the same, because aux already holds fat_readdir()'s
	  search-pool-slot bookkeeping here -- so a 64-bit DND* would silently
	  truncate. Revisit once fatfs_pfs.c's pluggable-mode cookie
	  representation is made pointer-width-safe without losing that
	  bookkeeping.

config CONF_WITH_PLUGGABLE_FS_TEST
	bool "Pluggable filesystem self-test driver"
	depends on CONF_WITH_PLUGGABLE_FS
	default n
	help
	  Registers a tiny built-in in-memory filesystem driver exposing a
	  single fixed drive letter with one read-only file, purely to
	  exercise the pluggable filesystem layer end-to-end without needing
	  a real driver.  Development/test scaffolding only; say n unless
	  you are testing the pluggable filesystem layer itself.

config CONF_PFS_MAX_SEARCHES
	int "Maximum concurrent pluggable Fsfirst/Fsnext searches"
	depends on CONF_WITH_PLUGGABLE_FS
	default 8
	range 1 40
	help
	  Number of concurrent Fsfirst/Fsnext directory searches the
	  pluggable filesystem layer can track at once, across all
	  pluggable drives and processes.  Each slot costs a handful of
	  bytes; raise this only if an application legitimately keeps many
	  directory searches open at the same time.

config CONF_PFS_MAX_CWD
	int "Maximum cached pluggable current directories"
	depends on CONF_WITH_PLUGGABLE_FS
	default 40
	range 1 40
	help
	  Number of distinct non-root current-directory cookies (across all
	  drives and processes) the pluggable filesystem layer can cache at
	  once - the pluggable-fs equivalent of the legacy dirtbl[]'s fixed
	  NCURDIR (40) capacity. Each slot costs a path buffer plus a
	  cookie, so lower this for a ROM/RAM-tight build that enables
	  CONF_WITH_PLUGGABLE_FS but doesn't need the full legacy capacity;
	  the default matches dirtbl[] so enabling pluggable fs support
	  doesn't reduce this system limit.

endmenu
```

## pm68k/Kconfig
```kconfig
#
# pemu68/Kconfig - 68k application emulation
#

menu "68k application emulation"

config CONF_WITH_PM68K
    bool "Run 68k applications through Musashi"
    depends on ARCH_ARM
    default n
    help
      Include the userspace 68000 compatibility runtime used to execute
      traditional 68k TOS applications on non-68k pTOS targets.

      Musashi provides the CPU core. pTOS provides memory access, GEMDOS,
      BIOS/XBIOS, VDI/AES translation and process integration.

endmenu
```

## tests/Kconfig
```kconfig
menu "Regression tests"

config CONF_WITH_REGRESSION_TESTS
    bool "Include built-in regression tests"
    default y
    help
      Build the regression test harness into a separate HD image.
      When enabled, 'make test-hd' produces a raw disk image that
      boots pTOS and runs the test suite automatically.

config CONF_WITH_X86_64_MEMTEST
    bool "Run the x86-64 memory-management self-test at boot"
    depends on MACHINE_PC_X86_64
    default y
    help
      At every boot, exercise the tracked process allocations, the
      growable kernel heap, per-process address spaces and KPROC records
      with repeated create/exit and injected-failure cycles, and check that
      none of them leaks (bios/machine/pc-x86_64/memtest.c).  The result is
      one line on the console, "x86-64 memtest: PASS" or "FAIL (n)", which
      the CI boot test looks for.  It takes a fraction of a second.

config CONF_WITH_X32_ACCESSORY_TEST
    bool "Exercise loaded x32 accessories and desktop restart at boot"
    depends on CONF_WITH_AES && ARCH_X86_64 && CONF_WITH_X86_64_MEMTEST
    depends on CONF_WITH_USER_CALLBACKS
    default n
    help
      Load the four ACC fixtures from make x32-accessory-test, verify
      cooperative message delivery, exit/fault and cancellation, and restart
      the desktop three times while checking tracked resources for leaks.
      Input regressions include real user callbacks revoking registrations
      while keyboard, mouse and timer waits are suspended.

config CONF_WITH_X32_DESKTOP_TEST
    bool "Report external x32 desktop integration checkpoints"
    depends on ARCH_X86_64 && CONF_EXTERNAL_DESK && CONF_WITH_USER_CALLBACKS
    depends on CONF_WITH_READ_INF && CONF_WITH_CLI && CONF_EXTERNAL_CLI
    default n
    help
      Emit serial-only markers from the real desktop for the QEMU PS/2
      integration driver, including CPL, menus, forms and USERDEF drawing.

endmenu
```

## usb/Kconfig
```kconfig
#
# usb/Kconfig - USB stack options
#
# Copyright (C) 2001-2017 The EmuTOS development team.
#
# This file is distributed under the GPL, version 2 or at your
# option any later version.  See doc/license.txt for details.
#

menu "USB support"

config CONF_WITH_USB
	bool "USB stack"
	depends on MACHINE_RPI && (!TARGET_RPI4 || CONF_WITH_PCI)
	default y
	help
	  A minimal USB stack, derived from the one in FreeMiNT and U-Boot.
	  It currently provides mice using the HID boot report protocol.
	  A host controller driver is required, so the stack is only
	  available on machines that have one.

config CONF_WITH_USB_DWC2
	bool
	default y if CONF_WITH_USB && MACHINE_RPI && !TARGET_RPI4
	help
	  The Synopsys DesignWare USB 2.0 OTG host controller, used on the
	  Raspberry Pi 1, 2 and 3.

config CONF_WITH_USB_XHCI
	bool
	depends on CONF_WITH_PCI
	default y if CONF_WITH_USB && TARGET_RPI4
	help
	  The xHCI host controller used for the Raspberry Pi 4/400 external
	  USB ports through the VL805 PCIe bridge.

endmenu
```
